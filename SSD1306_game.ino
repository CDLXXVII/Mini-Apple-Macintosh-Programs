#include <SPI.h>
#include <Wire.h>
#include <Adafruit_GFX.h>
#include <Adafruit_SSD1306.h>

#define SCREEN_WIDTH 128 // OLED display width, in pixels
#define SCREEN_HEIGHT 64 // OLED display height, in pixels
//int a=0;
int x=0;
int y=5;

  int r; // Reverse enemy movement flag
//  int PRX, PRY; //Projectile pos
  int PLX, PLY; //Player pos (Only top pixel/gun)
  int left = 0; //Button init
  int right = 1;
  int fire = 3;
  int leftst;
  int rightst;
  int firest;
  int base = 50; //Base clockspeed of the game [ms]
  int on = 0; //game status
  int PRS; // Projectile status

  int A[] = {3,3,3,3,3,4,4,4,4,4,5,5,5,5,5,6,6,6,6,6,7,7,7,7,7,1}; //Enemy 1 pos [0-24] status [25]
  int B[] = {3,3,3,3,3,4,4,4,4,4,5,5,5,5,5,6,6,6,6,6,7,7,7,7,7,1}; //Enemy 2 pos [0-24] status [25]
  int C[] = {3,3,3,3,3,4,4,4,4,4,5,5,5,5,5,6,6,6,6,6,7,7,7,7,7,1}; //Enemy 3 pos [0-24] status [25]
  int D[] = {3,3,3,3,3,4,4,4,4,4,5,5,5,5,5,6,6,6,6,6,7,7,7,7,7,1}; //Enemy 4 pos [0-24] status [25]
  int E[] = {3,3,3,3,3,4,4,4,4,4,5,5,5,5,5,6,6,6,6,6,7,7,7,7,7,1}; //Enemy 5 pos [0-24] status [25]
  int F[] = {3,3,3,3,3,4,4,4,4,4,5,5,5,5,5,6,6,6,6,6,7,7,7,7,7,1}; //Enemy 6 pos [0-24] status [25]

// Declaration for an SSD1306 display connected to I2C (SDA, SCL pins)
// The pins for I2C are defined by the Wire-library. 
// On an arduino UNO:       A4(SDA), A5(SCL)
// On an arduino MEGA 2560: 20(SDA), 21(SCL)
// On an arduino LEONARDO:   2(SDA),  3(SCL), ...
#define OLED_RESET     -1 // Reset pin # (or -1 if sharing Arduino reset pin)
#define SCREEN_ADDRESS 0x3C ///< See datasheet for Address; 0x3D for 128x64, 0x3C for 128x32
Adafruit_SSD1306 display(SCREEN_WIDTH, SCREEN_HEIGHT, &Wire, OLED_RESET);

static const uint8_t image_data_binbows[1024] = {
    // ∙∙∙∙∙∙∙∙∙∙∙∙∙∙∙∙∙∙∙∙∙∙∙∙∙∙∙██████████████████████████████████████████████████████████████████████████████∙∙∙∙∙∙∙∙∙∙∙∙∙∙∙∙∙∙∙∙∙∙∙
    // ∙∙∙∙∙∙∙∙∙∙∙∙∙∙∙∙∙∙∙∙∙∙∙∙∙∙∙██████████████████████████████████████████████████████████████████████████████∙∙∙∙∙∙∙∙∙∙∙∙∙∙∙∙∙∙∙∙∙∙∙
    // ∙∙∙∙∙∙∙∙∙∙∙∙∙∙∙∙∙∙∙∙∙∙∙∙∙∙∙██████████████████████████████████████████████████████████████████████████████∙∙∙∙∙∙∙∙∙∙∙∙∙∙∙∙∙∙∙∙∙∙∙
    // ∙∙∙∙∙∙∙∙∙∙∙∙∙∙∙∙∙∙∙∙∙∙∙∙∙∙∙██████████████████████████████████████████████████████████████████████████████∙∙∙∙∙∙∙∙∙∙∙∙∙∙∙∙∙∙∙∙∙∙∙
    // ∙∙∙∙∙∙∙∙∙∙∙∙∙∙∙∙∙∙∙∙∙∙∙∙∙∙∙████∙∙∙∙∙∙∙∙∙∙∙∙∙∙∙∙∙∙∙∙∙∙∙∙∙∙∙∙∙∙∙∙∙∙∙∙∙∙∙∙∙∙∙∙∙∙∙∙∙∙∙∙∙∙∙∙∙∙∙∙∙∙∙∙∙∙∙∙∙∙████∙∙∙∙∙∙∙∙∙∙∙∙∙∙∙∙∙∙∙∙∙∙∙
    // ∙∙∙∙∙∙∙∙∙∙∙∙∙∙∙∙∙∙∙∙∙∙∙∙∙∙∙████∙∙∙∙∙∙∙∙∙∙∙∙∙∙∙∙∙∙∙∙∙∙∙∙∙∙∙∙∙∙∙∙∙∙∙∙∙∙∙∙∙∙∙∙∙∙∙∙∙∙∙∙∙∙∙∙∙∙∙∙∙∙∙∙∙∙∙∙∙∙████∙∙∙∙∙∙∙∙∙∙∙∙∙∙∙∙∙∙∙∙∙∙∙
    // ∙∙∙∙∙∙∙∙∙∙∙∙∙∙∙∙∙∙∙∙∙∙∙∙∙∙∙████∙∙∙∙∙∙∙∙∙∙∙∙∙∙∙∙∙∙∙∙∙∙∙∙∙∙∙∙∙∙∙∙∙∙∙∙∙∙∙∙∙∙∙∙∙∙∙∙∙∙∙∙∙∙∙∙∙∙∙∙∙∙∙∙∙∙∙∙∙∙████∙∙∙∙∙∙∙∙∙∙∙∙∙∙∙∙∙∙∙∙∙∙∙
    // ∙∙∙∙∙∙∙∙∙∙∙∙∙∙∙∙∙∙∙∙∙∙∙∙∙∙∙████∙∙∙∙∙∙∙∙∙∙∙∙∙∙∙∙∙∙∙∙█∙∙∙∙∙∙∙∙∙█∙∙∙∙∙∙∙∙∙∙∙∙∙∙∙∙∙∙∙∙∙∙∙∙∙∙∙∙∙∙∙∙∙∙∙∙∙∙∙████∙∙∙∙∙∙∙∙∙∙∙∙∙∙∙∙∙∙∙∙∙∙∙
    // ∙∙∙∙∙∙∙∙∙∙∙∙∙∙∙∙∙∙∙∙∙∙∙∙∙∙∙████∙∙∙∙∙∙∙∙∙∙∙∙∙∙∙∙∙∙∙∙∙∙∙███∙∙∙█∙∙∙∙∙∙∙∙█∙∙█∙∙∙∙∙∙∙∙∙∙∙∙█∙∙∙∙∙∙∙∙∙∙∙∙∙∙∙████∙∙∙∙∙∙∙∙∙∙∙∙∙∙∙∙∙∙∙∙∙∙∙
    // ∙∙∙∙∙∙∙∙∙∙∙∙∙∙∙∙∙∙∙∙∙∙∙∙∙∙∙████∙∙∙∙∙∙∙∙∙∙∙∙∙∙∙∙∙∙█∙∙∙∙∙∙∙∙∙∙∙∙∙∙∙∙∙∙∙∙∙∙∙∙∙∙∙∙∙∙∙∙∙∙∙∙∙∙∙∙∙∙∙∙∙∙∙∙∙∙∙████∙∙∙∙∙∙∙∙∙∙∙∙∙∙∙∙∙∙∙∙∙∙∙
    // ∙∙∙∙∙∙∙∙∙∙∙∙∙∙∙∙∙∙∙∙∙∙∙∙∙∙∙████∙∙█∙∙∙∙∙∙∙∙∙∙∙∙∙∙∙∙∙∙∙∙∙∙∙∙∙∙∙∙∙∙∙∙∙∙∙∙∙∙∙∙∙∙∙∙∙∙∙∙∙∙∙∙∙∙∙∙∙∙∙∙∙∙∙∙∙∙∙████∙∙∙∙∙∙∙∙∙∙∙∙∙∙∙∙∙∙∙∙∙∙∙
    // ∙∙∙∙∙∙∙∙∙∙∙∙∙∙∙∙∙∙∙∙∙∙∙∙∙∙∙████∙∙∙∙∙∙∙∙∙∙∙∙∙∙∙∙∙∙∙∙∙∙∙∙∙∙∙∙∙∙∙∙∙∙∙∙∙∙∙∙∙∙∙∙∙∙∙∙∙∙∙∙∙∙∙∙∙∙∙∙∙∙∙∙∙∙∙∙∙∙████∙∙∙∙∙∙∙∙∙∙∙∙∙∙∙∙∙∙∙∙∙∙∙
    // ∙∙∙∙∙∙∙█∙∙∙∙∙∙∙∙∙∙∙∙∙∙∙∙∙∙∙████∙∙∙∙∙∙∙∙∙∙∙∙∙∙∙∙∙∙∙∙∙∙∙∙∙∙∙∙∙∙∙∙∙∙∙∙∙∙∙∙∙∙∙∙∙∙∙∙∙∙∙∙∙∙∙∙∙∙∙∙∙∙∙∙∙∙∙∙∙∙████∙∙∙∙∙∙∙∙∙∙∙∙∙∙∙∙∙∙∙∙∙∙∙
    // ∙∙∙∙∙∙∙∙∙∙∙∙∙∙∙∙∙∙∙∙∙∙∙∙∙∙∙██████████████████████████████████████████████████████████████████████████████∙∙∙∙∙∙∙∙∙∙∙∙∙∙∙∙∙∙∙∙∙∙∙
    // ∙∙∙∙∙∙∙∙∙∙∙∙∙∙∙∙∙∙∙∙∙∙∙∙∙∙∙██████████████████████████████████████████████████████████████████████████████∙∙∙∙∙∙∙∙∙∙∙∙∙∙∙∙∙∙∙∙∙∙∙
    // ∙∙∙∙∙∙∙∙∙∙∙∙∙∙∙∙∙∙∙∙∙∙∙∙∙∙∙██████████████████████████████████████████████████████████████████████████████∙∙∙∙∙∙∙∙∙∙∙∙∙∙∙∙∙∙∙∙∙∙∙
    // ∙∙∙∙∙∙∙∙∙∙∙∙∙∙∙∙∙∙∙∙∙∙∙█∙∙∙██████████████████████████████████████████████████████████████████████████████∙∙∙∙∙∙∙∙∙∙∙∙∙∙∙∙∙∙∙∙∙∙∙
    // ∙∙∙∙∙∙█∙∙∙∙∙∙∙∙∙∙∙∙∙∙∙∙∙∙∙∙██████████████████████████████████████████████████████████████████████████████∙∙∙∙∙∙∙∙∙∙∙∙∙∙∙∙∙∙∙∙∙∙∙
    // ∙∙∙∙∙∙∙∙∙∙∙∙∙∙∙∙∙∙∙∙∙∙∙∙∙∙∙██████████████████████████████████████████████████████████████████████████████∙∙∙∙∙∙∙∙∙∙∙∙∙∙∙∙∙∙∙∙∙∙∙
    // ∙∙∙∙∙∙∙∙█∙∙∙∙∙∙∙∙∙∙∙∙∙∙∙∙∙∙██████████████████████████████████████████████████████████████████████████████∙∙∙∙∙∙∙∙∙∙∙∙∙∙∙∙∙∙∙∙∙∙∙
    // ∙∙∙∙∙∙∙∙∙∙∙∙∙∙∙∙∙∙∙∙∙∙∙∙∙∙∙███████∙∙█∙∙∙∙████████████████████████████████████████████████████████████████∙∙∙∙∙∙∙∙∙∙∙∙∙∙∙∙∙∙∙∙∙∙∙
    // ∙∙∙∙∙∙∙∙∙∙∙∙∙∙∙∙∙∙∙∙∙∙∙∙∙∙∙████∙█∙████∙∙∙∙∙∙∙█████∙∙∙███∙█∙███∙██████∙█████∙∙████████████████████████████∙∙∙∙∙∙∙∙∙∙∙∙∙∙∙∙∙∙∙∙∙∙∙
    // ∙∙∙∙∙∙∙∙∙∙█∙∙∙∙∙∙∙∙∙∙∙∙∙∙∙∙██∙█████████∙∙∙∙∙∙∙∙∙∙∙∙∙∙███∙∙█∙∙█∙∙██∙∙∙∙██∙█∙∙∙████████████████████████████∙∙∙∙∙∙∙∙∙∙∙∙∙∙∙∙∙∙∙∙∙∙∙
    // ∙∙∙∙∙∙∙∙█∙∙∙∙∙∙∙∙∙∙∙∙∙∙∙∙∙∙████████████∙∙∙█∙∙∙∙∙∙∙∙∙∙████∙∙∙∙█∙█∙∙∙∙█∙█∙∙∙██∙████████████████████████████∙∙∙∙∙∙∙∙∙∙∙∙∙∙∙∙∙∙∙∙∙∙∙
    // ∙∙∙∙∙∙∙∙∙∙∙∙∙∙∙∙∙∙∙∙∙∙∙∙∙∙∙████████████∙∙∙████∙████∙∙████████████████████████████████████████████████████∙∙∙∙∙∙∙∙∙∙∙∙∙∙∙∙∙∙∙∙∙∙∙
    // ∙∙∙∙∙∙∙∙∙∙∙∙∙∙∙∙∙∙∙∙∙∙∙∙∙∙∙████████████∙∙∙███∙∙∙█∙█∙∙██████████████████████∙█████████████████████████████∙∙∙∙∙∙∙∙∙∙∙∙∙∙∙∙∙∙∙∙∙∙∙
    // ∙∙∙∙∙∙∙∙∙∙∙∙∙∙∙∙∙∙∙∙∙∙∙∙∙∙∙██████████∙██∙∙████∙∙███∙∙██∙∙∙∙∙███∙∙█████████∙∙█████████████████████████████∙∙∙∙∙∙∙∙∙∙∙∙∙∙∙∙∙∙∙∙∙∙∙
    // ∙∙∙∙∙∙∙∙∙∙∙∙∙∙∙∙∙∙∙∙∙∙∙∙∙∙∙██████∙█∙∙∙∙∙∙∙█∙█∙∙∙█∙█∙∙██∙∙██∙∙██∙∙█████████∙∙█████████████████████████████∙∙∙∙∙∙∙∙∙∙∙∙∙∙∙∙∙∙∙∙∙∙∙
    // ∙∙∙∙∙∙∙∙∙∙∙∙∙∙∙∙∙∙∙∙∙█∙∙∙∙∙████∙██████∙█∙∙∙∙∙∙∙∙██∙∙∙██∙∙███∙██████∙█∙∙███∙∙█∙∙█████∙∙███∙███∙███∙███∙∙██∙∙∙∙∙∙∙∙∙∙∙∙∙∙∙∙∙∙∙∙∙∙∙
    // ∙∙∙∙∙∙∙∙∙∙█∙∙█∙∙∙█∙∙∙∙█∙∙∙∙████████████∙∙█∙∙∙∙∙∙∙∙∙∙∙██∙∙██∙∙██∙∙██∙∙∙∙∙██∙∙∙∙∙∙██∙∙∙∙∙██∙∙██∙∙██∙██∙∙∙∙█∙∙∙∙∙∙∙∙∙∙∙∙∙∙∙∙∙∙∙∙∙∙∙
    // ∙∙∙∙∙∙∙∙∙∙∙∙∙∙∙∙∙∙∙∙∙∙∙∙∙∙∙████████████∙∙∙███∙∙∙∙█∙∙∙██∙∙∙∙∙███∙∙██∙∙██∙██∙∙███∙██∙∙██∙∙█∙∙█∙∙∙█∙∙█∙∙████∙∙∙∙∙∙∙∙∙∙∙∙∙∙∙∙∙∙∙∙∙∙∙
    // ∙∙∙∙∙∙∙∙∙∙∙∙∙∙∙∙∙∙∙∙∙∙∙∙∙∙∙████████████∙∙█████∙∙∙∙∙∙∙██∙∙██∙∙██∙∙██∙███∙██∙∙███∙∙█∙███∙∙██∙█∙∙∙█∙∙██∙∙∙██∙∙∙∙∙∙∙∙∙∙∙∙∙∙∙∙∙∙∙∙∙∙∙
    // ∙∙∙∙∙∙∙∙∙∙∙∙∙∙∙∙∙∙∙∙∙∙∙∙∙∙∙████████████∙∙∙████∙█∙█∙∙∙██∙∙███∙∙█∙∙██∙███∙██∙∙███∙∙█∙███∙∙██∙∙∙█∙∙∙████∙∙∙█∙∙∙∙∙∙∙∙∙∙∙∙∙∙∙∙∙∙∙∙∙∙∙
    // ∙∙∙∙∙∙∙∙∙∙∙∙∙∙∙∙∙∙∙∙∙∙∙∙∙∙∙██████████∙██∙█████∙∙█∙∙∙∙██∙∙███∙∙█∙∙██∙███∙██∙∙███∙██∙∙██∙∙██∙∙∙█∙∙∙█████∙∙█∙∙∙∙∙∙∙∙∙∙∙∙∙∙∙∙∙∙∙∙∙∙∙
    // ∙∙∙∙∙∙∙∙∙∙∙∙∙∙∙∙∙∙∙∙∙∙∙∙∙∙∙██████∙█∙∙∙∙∙∙∙∙███∙█∙█∙∙∙██∙∙∙∙∙∙██∙∙██∙███∙██∙∙∙∙∙∙██∙∙∙∙∙████∙∙██∙∙██∙∙∙∙∙█∙∙∙∙∙∙∙∙∙∙∙∙∙∙∙∙∙∙∙∙∙∙∙
    // ∙∙∙∙∙∙∙∙∙∙∙∙∙∙∙∙∙∙∙∙∙∙∙∙∙∙∙██∙█∙████████∙∙∙∙∙∙∙∙∙∙∙∙∙███∙∙∙████∙███∙███∙█████∙∙█████∙∙█████∙███∙████∙∙███∙∙∙∙∙∙∙∙∙∙∙∙∙∙∙∙∙∙∙∙∙∙∙
    // ∙∙∙∙∙∙∙∙∙∙∙∙∙∙∙∙∙∙∙∙∙∙∙∙∙∙∙███████████████∙∙∙∙∙∙∙∙∙∙█████████████████████████████████████████████████████∙∙∙∙∙∙∙∙∙∙∙∙∙∙∙∙∙∙∙∙∙∙∙
    // ∙∙∙∙∙∙∙∙∙∙∙∙∙∙∙∙∙∙∙∙∙∙∙∙∙∙∙██████████████████████████████████████████████████████████████████████████████∙∙∙∙∙∙∙∙∙∙∙∙∙∙∙∙∙∙∙∙∙∙∙
    // ∙∙∙∙∙∙█∙∙∙∙∙∙∙∙∙∙∙∙∙∙∙█∙∙∙∙██████████████████████████████████████████████████████████████████████████████∙∙∙∙∙∙∙∙∙∙∙∙∙∙∙∙∙∙∙∙∙∙∙
    // ∙∙∙∙∙∙∙∙∙∙∙∙∙∙∙∙∙∙∙∙∙∙∙∙∙∙∙██████████████████████████████████████████████████████████████████████████████∙∙∙∙∙∙∙∙∙∙∙∙∙∙∙∙∙∙∙∙∙∙∙
    // ∙∙∙∙∙∙∙∙∙∙∙∙∙∙∙∙∙∙∙∙∙∙∙∙∙∙∙██████████████████████████████████████████████████████████████████████████████∙∙∙∙∙∙∙∙∙∙∙∙∙∙∙∙∙∙∙∙∙∙∙
    // ∙∙∙∙∙∙∙█∙∙∙∙∙∙∙∙∙∙∙∙∙∙∙∙∙∙∙██████████████████████████████████████████████████████████████████████████████∙∙∙∙∙∙∙∙∙∙∙∙∙∙∙∙∙∙∙∙∙∙∙
    // ∙∙∙∙∙∙∙∙∙∙∙∙∙∙∙∙∙∙∙∙∙∙∙∙∙∙∙██████████████████████████████████████████████████████████████████████████████∙∙∙∙∙∙∙∙∙∙∙∙∙∙∙∙∙∙∙∙∙∙∙
    // ∙∙∙∙∙∙∙∙∙∙∙∙∙∙∙∙∙∙∙∙∙∙∙∙∙∙∙██████████████████████████████████████████████████████████████████████████████∙∙∙∙∙∙∙∙∙∙∙∙∙∙∙∙∙∙∙∙∙∙∙
    // ∙∙∙∙∙∙∙∙∙∙∙∙∙∙∙∙∙∙∙∙∙∙∙∙∙∙∙██████████████████████████████████████████████████████████████████████████████∙∙∙∙∙∙∙∙∙∙∙∙∙∙∙∙∙∙∙∙∙∙∙
    // ∙∙∙∙∙∙∙∙∙∙∙∙∙∙∙∙∙∙∙∙∙∙∙∙∙∙∙██████████████████████████████████████████████████████████████████████████████∙∙∙∙∙∙∙∙∙∙∙∙∙∙∙∙∙∙∙∙∙∙∙
    // ∙∙∙∙∙∙∙∙∙∙∙∙∙∙∙∙∙∙∙∙∙∙∙∙∙∙∙██████████████████████████████████████████████████████████████████████████████∙∙∙∙∙∙∙∙∙∙∙∙∙∙∙∙∙∙∙∙∙∙∙
    // ∙∙∙∙∙∙∙∙∙∙∙∙∙∙∙∙∙∙∙∙∙∙∙∙∙∙∙∙∙∙∙∙∙∙∙∙∙∙∙∙∙∙∙∙∙∙∙∙∙∙∙∙∙∙∙∙∙∙∙∙∙∙∙∙∙∙∙∙∙∙∙∙∙∙∙∙∙∙∙∙∙∙∙∙∙∙∙∙∙∙∙∙∙∙∙∙∙∙∙∙∙∙∙∙∙∙∙∙∙∙∙∙∙∙∙∙∙∙∙∙∙∙∙∙∙∙∙∙
    // ∙∙∙∙∙∙∙∙∙∙∙∙∙∙∙∙∙∙∙∙∙∙∙∙∙∙∙∙∙∙∙∙∙∙∙∙∙∙∙∙∙∙∙∙∙∙∙∙∙∙∙∙∙∙∙∙∙∙∙∙∙∙∙∙∙∙∙∙∙∙∙∙∙∙∙∙∙∙∙∙∙∙∙∙∙∙∙∙∙∙∙∙∙∙∙∙∙∙∙∙∙∙∙∙∙∙∙∙∙∙∙∙∙∙∙∙∙∙∙∙∙∙∙∙∙∙∙∙
    // ∙∙∙∙∙∙∙∙█∙∙∙∙∙∙∙∙∙∙∙∙∙∙∙∙∙∙∙∙∙∙∙∙∙∙∙∙∙∙∙∙∙∙∙∙∙∙∙∙∙∙∙∙∙∙∙∙∙∙∙∙∙∙∙∙∙∙∙∙∙∙∙∙∙∙∙∙∙∙∙∙∙∙∙∙∙∙∙∙∙∙∙∙∙∙∙∙∙∙∙∙∙∙∙∙∙∙∙∙∙∙∙∙∙∙∙∙∙∙∙∙∙∙∙∙∙∙∙
    // ∙∙∙∙∙∙∙∙∙∙∙∙∙∙∙∙∙∙∙∙∙∙∙∙∙∙∙∙∙∙∙∙∙∙∙∙∙∙∙∙∙∙∙∙∙∙∙∙██∙∙∙∙███∙∙∙∙∙∙∙∙∙██∙∙∙∙∙∙∙∙∙∙∙█∙∙∙∙∙∙∙∙∙∙∙∙∙∙∙███∙∙∙∙∙∙∙∙∙∙∙∙∙∙∙∙∙∙∙∙∙∙∙∙∙∙∙∙∙∙
    // ∙∙∙∙∙∙∙∙∙∙∙∙∙∙∙∙∙∙∙∙∙∙∙∙∙∙∙∙∙∙∙█████████∙∙∙∙∙∙∙████∙∙∙██∙∙∙∙∙∙∙█████∙∙∙∙███∙∙∙███∙∙████████∙∙∙∙███∙∙∙∙∙∙∙∙∙∙∙∙∙∙∙∙∙∙∙∙∙∙∙∙∙∙∙∙∙∙
    // ∙∙∙∙∙∙∙∙∙∙∙∙∙∙∙∙∙∙∙∙∙█∙∙∙∙∙∙∙∙∙█████████∙∙∙∙∙████∙∙∙∙████████∙∙██∙██∙∙∙∙∙███∙∙███∙∙████████∙∙∙∙███∙∙∙∙∙∙∙∙∙∙∙∙∙∙∙∙∙∙∙∙∙∙∙∙∙∙∙∙∙∙
    // ∙∙∙∙∙∙∙∙∙∙∙∙∙∙∙∙∙∙∙∙∙∙∙∙∙∙∙∙∙∙∙∙∙∙∙∙████∙∙∙∙████∙∙∙∙█████████∙∙██∙██∙███∙███∙∙███∙∙∙∙∙∙∙███∙∙∙∙█████∙∙∙∙∙∙∙∙∙∙∙∙∙∙∙∙∙∙∙∙∙∙∙∙∙∙∙∙
    // ∙∙∙∙∙∙∙∙∙∙∙∙∙∙∙∙∙∙∙∙∙∙∙∙∙∙∙∙∙∙∙∙███████∙∙∙██████∙∙∙∙███∙███∙∙∙∙██∙██∙███∙∙█∙∙███∙∙∙∙∙∙∙∙██∙∙∙∙∙██████∙∙∙∙∙∙∙∙∙∙∙∙∙∙∙∙∙∙∙∙∙∙∙∙∙∙∙
    // ∙∙∙∙∙∙∙∙∙∙∙∙∙∙∙∙∙∙∙∙∙∙∙∙∙∙∙∙∙∙∙∙██████∙∙∙███████∙∙∙∙██∙∙██∙∙∙∙███∙█████∙∙∙∙∙███∙∙∙∙∙∙∙∙███∙∙∙∙∙██████∙∙∙∙∙∙∙∙∙∙∙∙∙∙∙∙∙∙∙∙∙∙∙∙∙∙∙
    // ∙∙∙∙∙∙∙∙∙∙∙∙∙∙∙∙∙∙∙∙∙∙∙∙∙∙∙∙∙∙∙∙∙∙████∙∙∙∙█∙∙███∙∙∙∙∙∙∙███∙∙∙∙███∙█████∙∙∙∙████∙∙∙∙∙∙████∙∙∙∙∙∙███∙∙∙∙∙∙∙∙∙∙∙∙∙∙∙∙∙∙∙∙∙∙∙∙∙∙∙∙∙∙
    // ∙∙∙∙∙∙∙∙∙∙∙∙∙∙∙∙∙∙∙∙∙∙∙∙∙∙∙∙∙∙∙∙∙∙∙███∙∙∙∙∙∙∙███∙∙∙∙∙∙███∙∙∙∙∙███∙████∙∙∙█████∙∙∙∙∙∙████∙∙∙∙∙∙∙███∙∙∙∙∙∙∙∙∙∙∙∙∙∙∙∙∙∙∙∙∙∙∙∙∙∙∙∙∙∙
    // ∙∙∙∙∙∙∙∙∙∙∙∙∙∙∙∙∙∙∙∙∙∙∙∙∙∙∙∙∙∙∙∙∙∙∙∙██∙∙∙∙∙∙∙███∙∙∙∙∙∙██∙∙∙∙∙∙██∙∙██∙∙∙∙∙∙██∙∙∙∙∙∙∙∙███∙∙∙∙∙∙∙∙███∙∙∙∙∙∙∙∙∙∙∙∙∙∙∙∙∙∙∙∙∙∙∙∙∙∙∙∙∙∙
    // ∙∙∙∙∙∙∙∙∙∙∙∙∙∙∙∙∙∙∙∙∙∙∙∙∙∙∙∙∙∙∙∙∙∙∙∙∙∙∙∙∙∙∙∙∙∙█∙∙∙∙∙∙∙∙∙∙∙∙∙∙∙∙∙∙∙∙∙∙∙∙∙∙∙∙∙∙∙∙∙∙∙∙∙∙∙∙∙∙∙∙∙∙∙∙∙█∙∙∙∙∙∙∙∙∙∙∙∙∙∙∙∙∙∙∙∙∙∙∙∙∙∙∙∙∙∙∙
    // ∙∙∙∙∙∙∙∙∙∙∙∙∙∙∙∙∙∙∙∙∙∙∙∙∙∙∙∙∙∙∙∙∙∙∙∙∙∙∙∙∙∙∙∙∙∙∙∙∙∙∙∙∙∙∙∙∙∙∙∙∙∙∙∙∙∙∙∙∙∙∙∙∙∙∙∙∙∙∙∙∙∙∙∙∙∙∙∙∙∙∙∙∙∙∙∙∙∙∙∙∙∙∙∙∙∙∙∙∙∙∙∙∙∙∙∙∙∙∙∙∙∙∙∙∙∙∙∙
    // ∙∙∙∙∙∙∙∙∙∙∙∙∙∙∙∙∙∙∙∙∙∙∙∙∙∙∙∙∙∙∙∙∙∙∙∙∙∙∙∙∙∙∙∙∙∙∙∙∙∙∙∙∙∙∙∙∙∙∙∙∙∙∙∙∙∙∙∙∙∙∙∙∙∙∙∙∙∙∙∙∙∙∙∙∙∙∙∙∙∙∙∙∙∙∙∙∙∙∙∙∙∙∙∙∙∙∙∙∙∙∙∙∙∙∙∙∙∙∙∙∙∙∙∙∙∙∙∙
    // ∙∙∙∙∙∙∙∙∙∙∙∙∙∙∙∙∙∙∙∙∙∙∙∙∙∙∙∙∙∙∙∙∙∙∙∙∙∙∙∙∙∙∙∙∙∙∙∙∙∙∙∙∙∙∙∙∙∙∙∙∙∙∙∙∙∙∙∙∙∙∙∙∙∙∙∙∙∙∙∙∙∙∙∙∙∙∙∙∙∙∙∙∙∙∙∙∙∙∙∙∙∙∙∙∙∙∙∙∙∙∙∙∙∙∙∙∙∙∙∙∙∙∙∙∙∙∙∙
    // ∙∙∙∙∙∙∙∙∙∙∙∙∙∙∙∙∙∙∙∙∙∙∙∙∙∙∙∙∙∙∙∙∙∙∙∙∙∙∙∙∙∙∙∙∙∙∙∙∙∙∙∙∙∙∙∙∙∙∙∙∙∙∙∙∙∙∙∙∙∙∙∙∙∙∙∙∙∙∙∙∙∙∙∙∙∙∙∙∙∙∙∙∙∙∙∙∙∙∙∙∙∙∙∙∙∙∙∙∙∙∙∙∙∙∙∙∙∙∙∙∙∙∙∙∙∙∙∙
    0x00, 0x00, 0x00, 0x1f, 0xff, 0xff, 0xff, 0xff, 0xff, 0xff, 0xff, 0xff, 0xff, 0x80, 0x00, 0x00, 
    0x00, 0x00, 0x00, 0x1f, 0xff, 0xff, 0xff, 0xff, 0xff, 0xff, 0xff, 0xff, 0xff, 0x80, 0x00, 0x00, 
    0x00, 0x00, 0x00, 0x1f, 0xff, 0xff, 0xff, 0xff, 0xff, 0xff, 0xff, 0xff, 0xff, 0x80, 0x00, 0x00, 
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    0x00, 0x00, 0x00, 0x00, 0x00, 0x00, 0x00, 0x00, 0x00, 0x00, 0x00, 0x00, 0x00, 0x00, 0x00, 0x00
};
static const uint8_t image_data_boot1[1024] = {
    // ∙∙∙∙∙∙∙∙∙∙∙∙∙∙∙∙∙∙∙∙∙∙∙∙∙∙∙∙∙∙∙∙∙∙∙∙∙∙∙∙∙∙∙∙∙∙∙∙∙∙∙∙∙∙∙∙∙∙∙∙∙∙∙∙∙∙∙∙∙∙∙∙∙∙∙∙∙∙∙∙∙∙∙∙∙∙∙∙∙∙∙∙∙∙∙∙∙∙∙∙∙∙∙∙∙∙∙∙∙∙∙∙∙∙∙∙∙∙∙∙∙∙∙∙∙∙∙∙
    // ∙∙∙∙∙∙∙∙∙∙∙∙∙∙∙∙∙∙∙∙∙∙∙∙∙∙∙∙∙∙∙∙∙∙∙∙∙∙∙∙∙∙∙∙∙∙∙∙∙∙∙∙∙∙∙∙∙∙∙∙∙∙∙∙∙∙∙∙∙∙∙∙∙∙∙∙∙∙∙∙∙∙∙∙∙∙∙∙∙∙∙∙∙∙∙∙∙∙∙∙∙∙∙∙∙∙∙∙∙∙∙∙∙∙∙∙∙∙∙∙∙∙∙∙∙∙∙∙
    // ∙∙∙∙∙∙∙∙∙∙∙∙∙∙∙∙∙∙∙██████████████████████████████████████████████████████████████████████████████████████████∙∙∙∙∙∙∙∙∙∙∙∙∙∙∙∙∙∙∙
    // ∙∙∙∙∙∙∙∙∙∙∙∙∙∙∙∙∙∙∙█∙∙∙██∙∙∙∙██∙∙∙███∙∙∙██∙∙∙∙██∙∙∙███∙∙∙██∙∙∙∙██∙∙∙∙██∙∙∙███∙∙∙██∙∙∙∙██∙∙∙███∙∙∙██∙∙∙∙██∙∙∙█∙∙∙∙∙∙∙∙∙∙∙∙∙∙∙∙∙∙∙
    // ∙∙∙∙∙∙∙∙∙∙∙∙∙∙∙∙∙∙∙█∙∙∙██∙∙∙∙██∙∙∙███∙∙∙██∙∙∙∙██∙∙∙███∙∙∙██∙∙∙∙██∙∙∙∙██∙∙∙███∙∙∙██∙∙∙∙██∙∙∙███∙∙∙██∙∙∙∙██∙∙∙█∙∙∙∙∙∙∙∙∙∙∙∙∙∙∙∙∙∙∙
    // ∙∙∙∙∙∙∙∙∙∙∙∙∙∙∙∙∙∙∙███∙∙∙∙██∙∙∙∙██∙∙∙██∙∙∙∙██∙∙∙∙██∙∙∙█∙█∙∙∙██∙∙∙∙██∙∙∙∙██∙∙∙██∙∙∙∙██∙∙∙∙██∙∙∙██∙∙∙∙██∙∙∙∙███∙∙∙∙∙∙∙∙∙∙∙∙∙∙∙∙∙∙∙
    // ∙∙∙∙∙∙∙∙∙∙∙∙∙∙∙∙∙∙∙███∙∙∙∙██∙∙∙∙██∙∙█████████████████████████████████████████████████████████∙██∙∙∙∙██∙∙∙∙███∙∙∙∙∙∙∙∙∙∙∙∙∙∙∙∙∙∙∙
    // ∙∙∙∙∙∙∙∙∙∙∙∙∙∙∙∙∙∙∙█∙∙∙∙∙∙∙∙∙∙∙∙∙∙∙█∙∙∙∙∙∙∙∙∙∙∙∙∙∙∙∙∙∙∙∙∙∙∙∙∙∙∙∙∙∙∙∙∙∙∙∙∙∙∙∙∙∙∙∙∙∙∙∙∙∙∙∙∙∙∙∙∙█∙∙∙∙∙∙∙∙∙∙∙∙∙∙█∙∙∙∙∙∙∙∙∙∙∙∙∙∙∙∙∙∙∙
    // ∙∙∙∙∙∙∙∙∙∙∙∙∙∙∙∙∙∙∙█∙∙∙██∙∙∙∙██∙∙∙█∙█████████████████████████████████████████████████████████∙∙∙∙██∙∙∙∙██∙∙∙█∙∙∙∙∙∙∙∙∙∙∙∙∙∙∙∙∙∙∙
    // ∙∙∙∙∙∙∙∙∙∙∙∙∙∙∙∙∙∙∙█∙∙∙██∙∙∙∙██∙∙∙█∙█████████████████████████████████████████████████████████∙∙∙∙██∙∙∙∙██∙∙∙█∙∙∙∙∙∙∙∙∙∙∙∙∙∙∙∙∙∙∙
    // ∙∙∙∙∙∙∙∙∙∙∙∙∙∙∙∙∙∙∙█∙∙∙∙∙∙∙∙∙∙∙∙∙∙█∙█████████████████████████████████████████████████████████∙∙∙∙∙∙∙∙∙∙∙∙∙∙∙█∙∙∙∙∙∙∙∙∙∙∙∙∙∙∙∙∙∙∙
    // ∙∙∙∙∙∙∙∙∙∙∙∙∙∙∙∙∙∙∙███∙∙∙∙██∙∙∙∙███∙█████████████████████████████████████████████████████████∙██∙∙∙∙██∙∙∙∙███∙∙∙∙∙∙∙∙∙∙∙∙∙∙∙∙∙∙∙
    // ∙∙∙∙∙∙∙∙∙∙∙∙∙∙∙∙∙∙∙█∙∙∙∙∙∙∙∙∙∙∙∙∙∙█∙█████████████████████████████████████████████████████████∙∙∙∙∙∙∙∙∙∙∙∙∙∙∙█∙∙∙∙∙∙∙∙∙∙∙∙∙∙∙∙∙∙∙
    // ∙∙∙∙∙∙∙∙∙∙∙∙∙∙∙∙∙∙∙█∙∙∙██∙∙∙∙██∙∙∙█∙█████████████████████∙∙∙∙∙∙∙∙∙∙∙∙∙∙∙∙████████████████████∙∙∙∙██∙∙∙∙██∙∙∙█∙∙∙∙∙∙∙∙∙∙∙∙∙∙∙∙∙∙∙
    // ∙∙∙∙∙∙∙∙∙∙∙∙∙∙∙∙∙∙∙█∙∙∙██∙∙∙∙██∙∙∙█∙█████████████████████∙██████∙███████∙████████████████████∙∙∙∙██∙∙∙∙██∙∙∙█∙∙∙∙∙∙∙∙∙∙∙∙∙∙∙∙∙∙∙
    // ∙∙∙∙∙∙∙∙∙∙∙∙∙∙∙∙∙∙∙█∙∙∙∙∙∙∙∙∙∙∙∙∙∙█∙█████████████████████∙██████∙███████∙████████████████████∙∙∙∙∙∙∙∙∙∙∙∙∙∙∙█∙∙∙∙∙∙∙∙∙∙∙∙∙∙∙∙∙∙∙
    // ∙∙∙∙∙∙∙∙∙∙∙∙∙∙∙∙∙∙∙███∙∙∙∙██∙∙∙∙███∙█████████████████████∙███∙█∙██∙█████∙████████████████████∙██∙∙∙∙██∙∙∙∙███∙∙∙∙∙∙∙∙∙∙∙∙∙∙∙∙∙∙∙
    // ∙∙∙∙∙∙∙∙∙∙∙∙∙∙∙∙∙∙∙███∙∙∙∙██∙∙∙∙███∙█████████████████████∙█████∙████████∙████████████████████∙██∙∙∙∙██∙∙∙∙███∙∙∙∙∙∙∙∙∙∙∙∙∙∙∙∙∙∙∙
    // ∙∙∙∙∙∙∙∙∙∙∙∙∙∙∙∙∙∙∙█∙∙∙██∙∙∙∙██∙∙∙█∙█████████████████████∙█████∙████████∙████████████████████∙∙∙∙██∙∙∙∙██∙∙∙█∙∙∙∙∙∙∙∙∙∙∙∙∙∙∙∙∙∙∙
    // ∙∙∙∙∙∙∙∙∙∙∙∙∙∙∙∙∙∙∙█∙∙∙██∙∙∙∙██∙∙∙█∙█████████████████████∙████∙█████████∙████████████████████∙∙∙∙██∙∙∙∙██∙∙∙█∙∙∙∙∙∙∙∙∙∙∙∙∙∙∙∙∙∙∙
    // ∙∙∙∙∙∙∙∙∙∙∙∙∙∙∙∙∙∙∙█∙∙∙∙∙∙∙∙∙∙∙∙∙∙█∙█████████████████████∙█████∙∙∙██████∙████████████████████∙∙∙∙∙∙∙∙∙∙∙∙∙∙∙█∙∙∙∙∙∙∙∙∙∙∙∙∙∙∙∙∙∙∙
    // ∙∙∙∙∙∙∙∙∙∙∙∙∙∙∙∙∙∙∙███∙∙∙∙██∙∙∙∙███∙█████████████████████∙██████████████∙████████████████████∙██∙∙∙∙██∙∙∙∙███∙∙∙∙∙∙∙∙∙∙∙∙∙∙∙∙∙∙∙
    // ∙∙∙∙∙∙∙∙∙∙∙∙∙∙∙∙∙∙∙███∙∙∙∙██∙∙∙∙███∙█████████████████████∙██∙∙∙∙∙∙∙∙████∙████████████████████∙██∙∙∙∙██∙∙∙∙███∙∙∙∙∙∙∙∙∙∙∙∙∙∙∙∙∙∙∙
    // ∙∙∙∙∙∙∙∙∙∙∙∙∙∙∙∙∙∙∙█∙∙∙██∙∙∙∙██∙∙∙█∙█████████████████████∙██████████████∙████████████████████∙∙∙∙██∙∙∙∙██∙∙∙█∙∙∙∙∙∙∙∙∙∙∙∙∙∙∙∙∙∙∙
    // ∙∙∙∙∙∙∙∙∙∙∙∙∙∙∙∙∙∙∙█∙∙∙██∙∙∙∙██∙∙∙█∙█████████████████████∙███████∙██████∙████████████████████∙∙∙∙██∙∙∙∙██∙∙∙█∙∙∙∙∙∙∙∙∙∙∙∙∙∙∙∙∙∙∙
    // ∙∙∙∙∙∙∙∙∙∙∙∙∙∙∙∙∙∙∙█∙∙∙∙∙∙∙∙∙∙∙∙∙∙█∙█████████████████████∙███████∙██████∙████████████████████∙∙∙∙∙∙∙∙∙∙∙∙∙∙∙█∙∙∙∙∙∙∙∙∙∙∙∙∙∙∙∙∙∙∙
    // ∙∙∙∙∙∙∙∙∙∙∙∙∙∙∙∙∙∙∙███∙∙∙∙██∙∙∙∙███∙█████████████████████∙∙∙∙∙∙∙∙∙∙∙∙∙∙∙∙████████████████████∙██∙∙∙∙██∙∙∙∙███∙∙∙∙∙∙∙∙∙∙∙∙∙∙∙∙∙∙∙
    // ∙∙∙∙∙∙∙∙∙∙∙∙∙∙∙∙∙∙∙███∙∙∙∙██∙∙∙∙███∙█████████████████████████████████████████████████████████∙██∙∙∙∙██∙∙∙∙███∙∙∙∙∙∙∙∙∙∙∙∙∙∙∙∙∙∙∙
    // ∙∙∙∙∙∙∙∙∙∙∙∙∙∙∙∙∙∙∙█∙∙∙█∙∙∙∙∙∙█∙∙∙█∙█████████████████∙███∙███████████████∙∙██████████████████∙∙∙∙█∙∙∙∙∙∙█∙∙∙█∙∙∙∙∙∙∙∙∙∙∙∙∙∙∙∙∙∙∙
    // ∙∙∙∙∙∙∙∙∙∙∙∙∙∙∙∙∙∙∙█∙∙∙██∙∙∙∙██∙∙∙█∙█████████████████∙███∙███████∙█∙███∙█████████████████████∙∙∙∙██∙∙∙∙██∙∙∙█∙∙∙∙∙∙∙∙∙∙∙∙∙∙∙∙∙∙∙
    // ∙∙∙∙∙∙∙∙∙∙∙∙∙∙∙∙∙∙∙█∙∙∙∙∙∙∙∙∙∙∙∙∙∙█∙██████████████████∙██∙█∙∙███∙██∙███∙█∙███████████████████∙∙∙∙∙∙∙∙∙∙∙∙∙∙∙█∙∙∙∙∙∙∙∙∙∙∙∙∙∙∙∙∙∙∙
    // ∙∙∙∙∙∙∙∙∙∙∙∙∙∙∙∙∙∙∙███∙∙∙∙██∙∙∙∙███∙██████████████████∙██∙████∙████∙███∙██∙██████████████████∙██∙∙∙∙██∙∙∙∙███∙∙∙∙∙∙∙∙∙∙∙∙∙∙∙∙∙∙∙
    // ∙∙∙∙∙∙∙∙∙∙∙∙∙∙∙∙∙∙∙███∙∙∙∙██∙∙∙∙███∙███████████████████∙█∙██∙█∙████∙███∙███∙█████████████████∙██∙∙∙∙██∙∙∙∙███∙∙∙∙∙∙∙∙∙∙∙∙∙∙∙∙∙∙∙
    // ∙∙∙∙∙∙∙∙∙∙∙∙∙∙∙∙∙∙∙█∙∙∙∙∙∙∙∙∙∙∙∙∙∙█∙█████████████████∙█∙█∙█∙██∙████∙████∙██∙█████████████████∙∙∙∙∙∙∙∙∙∙∙∙∙∙∙█∙∙∙∙∙∙∙∙∙∙∙∙∙∙∙∙∙∙∙
    // ∙∙∙∙∙∙∙∙∙∙∙∙∙∙∙∙∙∙∙█∙∙∙██∙∙∙∙██∙∙∙█∙█████████████████∙█████∙█∙█∙█████████∙███████████████████∙∙∙∙██∙∙∙∙██∙∙∙█∙∙∙∙∙∙∙∙∙∙∙∙∙∙∙∙∙∙∙
    // ∙∙∙∙∙∙∙∙∙∙∙∙∙∙∙∙∙∙∙█∙∙∙█∙∙∙∙∙∙█∙∙∙█∙█████████████████████████████████████████████████████████∙∙∙∙█∙∙∙∙∙∙█∙∙∙█∙∙∙∙∙∙∙∙∙∙∙∙∙∙∙∙∙∙∙
    // ∙∙∙∙∙∙∙∙∙∙∙∙∙∙∙∙∙∙∙███∙∙∙∙██∙∙∙∙███∙█████████████████████████████████████████████████████████∙██∙∙∙∙██∙∙∙∙███∙∙∙∙∙∙∙∙∙∙∙∙∙∙∙∙∙∙∙
    // ∙∙∙∙∙∙∙∙∙∙∙∙∙∙∙∙∙∙∙███∙∙∙∙██∙∙∙∙███∙█████████████████████████████████████████████████████████∙██∙∙∙∙██∙∙∙∙███∙∙∙∙∙∙∙∙∙∙∙∙∙∙∙∙∙∙∙
    // ∙∙∙∙∙∙∙∙∙∙∙∙∙∙∙∙∙∙∙█∙∙∙∙∙∙∙∙∙∙∙∙∙∙█∙█████████████████████████████████████████████████████████∙∙∙∙∙∙∙∙∙∙∙∙∙∙∙█∙∙∙∙∙∙∙∙∙∙∙∙∙∙∙∙∙∙∙
    // ∙∙∙∙∙∙∙∙∙∙∙∙∙∙∙∙∙∙∙█∙∙∙██∙∙∙∙██∙∙∙█∙███████████████████████∙█∙██∙███∙████████████████████████∙∙∙∙██∙∙∙∙██∙∙∙█∙∙∙∙∙∙∙∙∙∙∙∙∙∙∙∙∙∙∙
    // ∙∙∙∙∙∙∙∙∙∙∙∙∙∙∙∙∙∙∙█∙∙∙██∙∙∙∙██∙∙∙█∙█████████████████████████████∙██∙████████████████████████∙∙∙∙██∙∙∙∙██∙∙∙█∙∙∙∙∙∙∙∙∙∙∙∙∙∙∙∙∙∙∙
    // ∙∙∙∙∙∙∙∙∙∙∙∙∙∙∙∙∙∙∙███∙∙∙∙██∙∙∙∙███∙█████████████████████████████████████████████████████████∙██∙∙∙∙██∙∙∙∙███∙∙∙∙∙∙∙∙∙∙∙∙∙∙∙∙∙∙∙
    // ∙∙∙∙∙∙∙∙∙∙∙∙∙∙∙∙∙∙∙███∙∙∙∙██∙∙∙∙███∙█████████████████████████████████████████████████████████∙██∙∙∙∙██∙∙∙∙███∙∙∙∙∙∙∙∙∙∙∙∙∙∙∙∙∙∙∙
    // ∙∙∙∙∙∙∙∙∙∙∙∙∙∙∙∙∙∙∙█∙∙∙∙∙∙∙∙∙∙∙∙∙∙█∙██████████████∙∙∙████████████████████████████████████████∙∙∙∙∙∙∙∙∙∙∙∙∙∙∙█∙∙∙∙∙∙∙∙∙∙∙∙∙∙∙∙∙∙∙
    // ∙∙∙∙∙∙∙∙∙∙∙∙∙∙∙∙∙∙∙█∙∙∙██∙∙∙∙██∙∙∙█∙██████████████∙∙∙████████████████████████████████████████∙∙∙∙██∙∙∙∙██∙∙∙█∙∙∙∙∙∙∙∙∙∙∙∙∙∙∙∙∙∙∙
    // ∙∙∙∙∙∙∙∙∙∙∙∙∙∙∙∙∙∙∙█∙∙∙██∙∙∙∙██∙∙∙█∙█████████████████████████████████████████████████████████∙∙∙∙██∙∙∙∙██∙∙∙█∙∙∙∙∙∙∙∙∙∙∙∙∙∙∙∙∙∙∙
    // ∙∙∙∙∙∙∙∙∙∙∙∙∙∙∙∙∙∙∙███∙∙∙∙██∙∙∙∙███∙█████████████████████████████████████████████████████████∙██∙∙∙∙██∙∙∙∙███∙∙∙∙∙∙∙∙∙∙∙∙∙∙∙∙∙∙∙
    // ∙∙∙∙∙∙∙∙∙∙∙∙∙∙∙∙∙∙∙███∙∙∙∙██∙∙∙∙███∙█████████████████████████████████████████████████████████∙██∙∙∙∙██∙∙∙∙███∙∙∙∙∙∙∙∙∙∙∙∙∙∙∙∙∙∙∙
    // ∙∙∙∙∙∙∙∙∙∙∙∙∙∙∙∙∙∙∙█∙∙∙∙∙∙∙∙∙∙∙∙∙∙█∙∙∙∙∙∙∙∙∙∙∙∙∙∙∙∙∙∙∙∙∙∙∙∙∙∙∙∙∙∙∙∙∙∙∙∙∙∙∙∙∙∙∙∙∙∙∙∙∙∙∙∙∙∙∙∙∙∙█∙∙∙∙∙∙∙∙∙∙∙∙∙∙█∙∙∙∙∙∙∙∙∙∙∙∙∙∙∙∙∙∙∙
    // ∙∙∙∙∙∙∙∙∙∙∙∙∙∙∙∙∙∙∙█∙∙∙██∙∙∙∙██∙∙∙███∙∙∙███∙∙███∙∙∙███∙∙∙███∙∙████∙∙███∙∙∙███∙∙∙███∙∙███∙∙∙███∙∙∙██∙∙∙∙██∙∙∙█∙∙∙∙∙∙∙∙∙∙∙∙∙∙∙∙∙∙∙
    // ∙∙∙∙∙∙∙∙∙∙∙∙∙∙∙∙∙∙∙█∙∙∙██∙∙∙∙██∙∙∙███∙∙∙██∙∙∙∙██∙∙∙███∙∙∙██∙∙∙∙██∙∙∙∙██∙∙∙███∙∙∙██∙∙∙∙██∙∙∙███∙∙∙██∙∙∙∙██∙∙∙█∙∙∙∙∙∙∙∙∙∙∙∙∙∙∙∙∙∙∙
    // ∙∙∙∙∙∙∙∙∙∙∙∙∙∙∙∙∙∙∙█∙∙∙∙∙∙∙∙∙∙∙∙∙∙∙∙∙∙∙∙∙∙∙∙∙∙∙∙∙∙∙∙∙∙∙∙∙∙∙∙∙∙∙∙∙∙∙∙∙∙∙∙∙∙∙∙∙∙∙∙∙∙∙∙∙∙∙∙∙∙∙∙∙∙∙∙∙∙∙∙∙∙∙∙∙∙∙∙█∙∙∙∙∙∙∙∙∙∙∙∙∙∙∙∙∙∙∙
    // ∙∙∙∙∙∙∙∙∙∙∙∙∙∙∙∙∙∙∙███∙∙∙∙██∙∙∙∙██∙∙∙██∙∙∙∙██∙∙∙∙██∙∙∙███∙∙∙██∙∙∙∙██∙∙∙███∙∙∙██∙∙∙∙██∙∙∙∙██∙∙∙██∙∙∙∙██∙∙∙∙███∙∙∙∙∙∙∙∙∙∙∙∙∙∙∙∙∙∙∙
    // ∙∙∙∙∙∙∙∙∙∙∙∙∙∙∙∙∙∙∙█∙∙∙∙∙∙∙∙∙∙∙∙∙∙∙∙∙∙∙∙∙∙∙∙∙∙∙∙∙∙∙∙∙∙∙∙∙∙∙∙∙∙∙∙∙∙∙∙∙∙∙∙∙∙∙∙∙∙∙∙∙∙∙∙∙∙∙∙∙∙∙∙∙∙∙∙∙∙∙∙∙∙∙∙∙∙∙∙█∙∙∙∙∙∙∙∙∙∙∙∙∙∙∙∙∙∙∙
    // ∙∙∙∙∙∙∙∙∙∙∙∙∙∙∙∙∙∙∙█∙∙∙██∙∙∙∙██∙∙∙███∙∙∙██∙∙∙∙██∙∙∙███∙∙∙██∙∙∙∙██∙∙∙∙██∙∙∙███∙∙∙██∙∙∙∙██∙∙∙███∙∙∙██∙∙∙∙██∙∙∙█∙∙∙∙∙∙∙∙∙∙∙∙∙∙∙∙∙∙∙
    // ∙∙∙∙∙∙∙∙∙∙∙∙∙∙∙∙∙∙∙█∙∙∙██∙∙∙∙██∙∙∙███∙∙∙██∙∙∙∙██∙∙∙███∙∙∙██∙∙∙∙██∙∙∙∙██∙∙∙███∙∙∙██∙∙∙∙██∙∙∙███∙∙∙██∙∙∙∙██∙∙∙█∙∙∙∙∙∙∙∙∙∙∙∙∙∙∙∙∙∙∙
    // ∙∙∙∙∙∙∙∙∙∙∙∙∙∙∙∙∙∙∙█∙∙∙∙∙∙∙∙∙∙∙∙∙∙∙∙∙∙∙∙∙∙∙∙∙∙∙∙∙∙∙∙∙∙∙∙∙∙∙∙∙∙∙∙∙∙∙∙∙∙∙∙∙∙∙∙∙∙∙∙∙∙∙∙∙∙∙∙∙∙∙∙∙∙∙∙∙∙∙∙∙∙∙∙∙∙∙█∙∙∙∙∙∙∙∙∙∙∙∙∙∙∙∙∙∙∙∙
    // ∙∙∙∙∙∙∙∙∙∙∙∙∙∙∙∙∙∙∙███∙∙∙∙██∙∙∙∙██∙∙∙██∙∙∙∙██∙∙∙∙██∙∙∙███∙∙∙██∙∙∙∙██∙∙∙███∙∙∙██∙∙∙∙██∙∙∙∙██∙∙∙██∙∙∙∙██∙∙∙∙███∙∙∙∙∙∙∙∙∙∙∙∙∙∙∙∙∙∙∙
    // ∙∙∙∙∙∙∙∙∙∙∙∙∙∙∙∙∙∙∙███∙∙∙∙██∙∙∙∙██∙∙∙██∙∙∙∙██∙∙∙∙██∙∙∙███∙∙∙██∙∙∙∙██∙∙∙∙██∙∙∙██∙∙∙∙██∙∙∙∙██∙∙∙██∙∙∙∙██∙∙∙∙███∙∙∙∙∙∙∙∙∙∙∙∙∙∙∙∙∙∙∙
    // ∙∙∙∙∙∙∙∙∙∙∙∙∙∙∙∙∙∙∙█∙∙∙██∙∙∙∙██∙∙∙███∙∙∙██∙∙∙∙██∙∙∙███∙∙∙██∙∙∙∙██∙∙∙∙██∙∙∙███∙∙∙██∙∙∙∙██∙∙∙███∙∙∙██∙∙∙∙██∙∙∙█∙∙∙∙∙∙∙∙∙∙∙∙∙∙∙∙∙∙∙
    // ∙∙∙∙∙∙∙∙∙∙∙∙∙∙∙∙∙∙∙█∙∙∙██∙∙∙∙██∙∙∙███∙∙∙██∙∙∙∙██∙∙∙███∙∙∙██∙∙∙∙██∙∙∙∙██∙∙∙███∙∙∙██∙∙∙∙██∙∙∙███∙∙∙██∙∙∙∙██∙∙∙█∙∙∙∙∙∙∙∙∙∙∙∙∙∙∙∙∙∙∙
    // ∙∙∙∙∙∙∙∙∙∙∙∙∙∙∙∙∙∙∙██████████████████████████████████████████████████████████████████████████████████████████∙∙∙∙∙∙∙∙∙∙∙∙∙∙∙∙∙∙∙
    // ∙∙∙∙∙∙∙∙∙∙∙∙∙∙∙∙∙∙∙∙∙∙∙∙∙∙∙∙∙∙∙∙∙∙∙∙∙∙∙∙∙∙∙∙∙∙∙∙∙∙∙∙∙∙∙∙∙∙∙∙∙∙∙∙∙∙∙∙∙∙∙∙∙∙∙∙∙∙∙∙∙∙∙∙∙∙∙∙∙∙∙∙∙∙∙∙∙∙∙∙∙∙∙∙∙∙∙∙∙∙∙∙∙∙∙∙∙∙∙∙∙∙∙∙∙∙∙∙
    // ∙∙∙∙∙∙∙∙∙∙∙∙∙∙∙∙∙∙∙∙∙∙∙∙∙∙∙∙∙∙∙∙∙∙∙∙∙∙∙∙∙∙∙∙∙∙∙∙∙∙∙∙∙∙∙∙∙∙∙∙∙∙∙∙∙∙∙∙∙∙∙∙∙∙∙∙∙∙∙∙∙∙∙∙∙∙∙∙∙∙∙∙∙∙∙∙∙∙∙∙∙∙∙∙∙∙∙∙∙∙∙∙∙∙∙∙∙∙∙∙∙∙∙∙∙∙∙∙
    0x00, 0x00, 0x00, 0x00, 0x00, 0x00, 0x00, 0x00, 0x00, 0x00, 0x00, 0x00, 0x00, 0x00, 0x00, 0x00, 
    0x00, 0x00, 0x00, 0x00, 0x00, 0x00, 0x00, 0x00, 0x00, 0x00, 0x00, 0x00, 0x00, 0x00, 0x00, 0x00, 
    0x00, 0x00, 0x1f, 0xff, 0xff, 0xff, 0xff, 0xff, 0xff, 0xff, 0xff, 0xff, 0xff, 0xf8, 0x00, 0x00, 
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    0x00, 0x00, 0x00, 0x00, 0x00, 0x00, 0x00, 0x00, 0x00, 0x00, 0x00, 0x00, 0x00, 0x00, 0x00, 0x00
};
static const uint8_t image_data_boot2[1024] = {
    // ∙∙∙∙∙∙∙∙∙∙∙∙∙∙∙∙∙∙∙∙∙∙∙∙∙∙∙∙∙∙∙∙∙∙∙∙∙∙∙∙∙∙∙∙∙∙∙∙∙∙∙∙∙∙∙∙∙∙∙∙∙∙∙∙∙∙∙∙∙∙∙∙∙∙∙∙∙∙∙∙∙∙∙∙∙∙∙∙∙∙∙∙∙∙∙∙∙∙∙∙∙∙∙∙∙∙∙∙∙∙∙∙∙∙∙∙∙∙∙∙∙∙∙∙∙∙∙∙
    // ∙∙∙∙∙∙∙∙∙∙∙∙∙∙∙∙∙∙∙∙∙∙∙∙∙∙∙∙∙∙∙∙∙∙∙∙∙∙∙∙∙∙∙∙∙∙∙∙∙∙∙∙∙∙∙∙∙∙∙∙∙∙∙∙∙∙∙∙∙∙∙∙∙∙∙∙∙∙∙∙∙∙∙∙∙∙∙∙∙∙∙∙∙∙∙∙∙∙∙∙∙∙∙∙∙∙∙∙∙∙∙∙∙∙∙∙∙∙∙∙∙∙∙∙∙∙∙∙
    // ∙∙∙∙∙∙∙∙∙∙∙∙∙∙∙∙∙∙∙██████████████████████████████████████████████████████████████████████████████████████████∙∙∙∙∙∙∙∙∙∙∙∙∙∙∙∙∙∙∙
    // ∙∙∙∙∙∙∙∙∙∙∙∙∙∙∙∙∙∙∙█∙∙∙██∙∙∙∙██∙∙∙███∙∙∙██∙∙∙∙██∙∙∙███∙∙∙██∙∙∙∙██∙∙∙∙██∙∙∙███∙∙∙██∙∙∙∙██∙∙∙███∙∙∙██∙∙∙∙██∙∙∙█∙∙∙∙∙∙∙∙∙∙∙∙∙∙∙∙∙∙∙
    // ∙∙∙∙∙∙∙∙∙∙∙∙∙∙∙∙∙∙∙█∙∙∙██∙∙∙∙██∙∙∙███∙∙∙██∙∙∙∙██∙∙∙███∙∙∙██∙∙∙∙██∙∙∙∙██∙∙∙███∙∙∙██∙∙∙∙██∙∙∙███∙∙∙██∙∙∙∙██∙∙∙█∙∙∙∙∙∙∙∙∙∙∙∙∙∙∙∙∙∙∙
    // ∙∙∙∙∙∙∙∙∙∙∙∙∙∙∙∙∙∙∙███∙∙∙∙██∙∙∙∙██∙∙∙██∙∙∙∙██∙∙∙∙██∙∙∙█∙█∙∙∙██∙∙∙∙██∙∙∙∙██∙∙∙██∙∙∙∙██∙∙∙∙██∙∙∙██∙∙∙∙██∙∙∙∙███∙∙∙∙∙∙∙∙∙∙∙∙∙∙∙∙∙∙∙
    // ∙∙∙∙∙∙∙∙∙∙∙∙∙∙∙∙∙∙∙███∙∙∙∙██∙∙∙∙██∙∙█████████████████████████████████████████████████████████∙██∙∙∙∙██∙∙∙∙███∙∙∙∙∙∙∙∙∙∙∙∙∙∙∙∙∙∙∙
    // ∙∙∙∙∙∙∙∙∙∙∙∙∙∙∙∙∙∙∙█∙∙∙∙∙∙∙∙∙∙∙∙∙∙∙█∙∙∙∙∙∙∙∙∙∙∙∙∙∙∙∙∙∙∙∙∙∙∙∙∙∙∙∙∙∙∙∙∙∙∙∙∙∙∙∙∙∙∙∙∙∙∙∙∙∙∙∙∙∙∙∙∙█∙∙∙∙∙∙∙∙∙∙∙∙∙∙█∙∙∙∙∙∙∙∙∙∙∙∙∙∙∙∙∙∙∙
    // ∙∙∙∙∙∙∙∙∙∙∙∙∙∙∙∙∙∙∙█∙∙∙██∙∙∙∙██∙∙∙█∙█████████████████████████████████████████████████████████∙∙∙∙██∙∙∙∙██∙∙∙█∙∙∙∙∙∙∙∙∙∙∙∙∙∙∙∙∙∙∙
    // ∙∙∙∙∙∙∙∙∙∙∙∙∙∙∙∙∙∙∙█∙∙∙██∙∙∙∙██∙∙∙█∙█████████████████████████████████████████████████████████∙∙∙∙██∙∙∙∙██∙∙∙█∙∙∙∙∙∙∙∙∙∙∙∙∙∙∙∙∙∙∙
    // ∙∙∙∙∙∙∙∙∙∙∙∙∙∙∙∙∙∙∙█∙∙∙∙∙∙∙∙∙∙∙∙∙∙█∙█████████████████████████████████████████████████████████∙∙∙∙∙∙∙∙∙∙∙∙∙∙∙█∙∙∙∙∙∙∙∙∙∙∙∙∙∙∙∙∙∙∙
    // ∙∙∙∙∙∙∙∙∙∙∙∙∙∙∙∙∙∙∙███∙∙∙∙██∙∙∙∙███∙█████████████████████████████████████████████████████████∙██∙∙∙∙██∙∙∙∙███∙∙∙∙∙∙∙∙∙∙∙∙∙∙∙∙∙∙∙
    // ∙∙∙∙∙∙∙∙∙∙∙∙∙∙∙∙∙∙∙█∙∙∙∙∙∙∙∙∙∙∙∙∙∙█∙█████████████████████████████████████████████████████████∙∙∙∙∙∙∙∙∙∙∙∙∙∙∙█∙∙∙∙∙∙∙∙∙∙∙∙∙∙∙∙∙∙∙
    // ∙∙∙∙∙∙∙∙∙∙∙∙∙∙∙∙∙∙∙█∙∙∙██∙∙∙∙██∙∙∙█∙█████████████████████∙∙∙∙∙∙∙∙∙∙∙∙∙∙∙∙████████████████████∙∙∙∙██∙∙∙∙██∙∙∙█∙∙∙∙∙∙∙∙∙∙∙∙∙∙∙∙∙∙∙
    // ∙∙∙∙∙∙∙∙∙∙∙∙∙∙∙∙∙∙∙█∙∙∙██∙∙∙∙██∙∙∙█∙█████████████████████∙██████∙███████∙████████████████████∙∙∙∙██∙∙∙∙██∙∙∙█∙∙∙∙∙∙∙∙∙∙∙∙∙∙∙∙∙∙∙
    // ∙∙∙∙∙∙∙∙∙∙∙∙∙∙∙∙∙∙∙█∙∙∙∙∙∙∙∙∙∙∙∙∙∙█∙█████████████████████∙██████∙███████∙████████████████████∙∙∙∙∙∙∙∙∙∙∙∙∙∙∙█∙∙∙∙∙∙∙∙∙∙∙∙∙∙∙∙∙∙∙
    // ∙∙∙∙∙∙∙∙∙∙∙∙∙∙∙∙∙∙∙███∙∙∙∙██∙∙∙∙███∙█████████████████████∙███∙██∙██∙████∙████████████████████∙██∙∙∙∙██∙∙∙∙███∙∙∙∙∙∙∙∙∙∙∙∙∙∙∙∙∙∙∙
    // ∙∙∙∙∙∙∙∙∙∙∙∙∙∙∙∙∙∙∙███∙∙∙∙██∙∙∙∙███∙█████████████████████∙██████∙███████∙████████████████████∙██∙∙∙∙██∙∙∙∙███∙∙∙∙∙∙∙∙∙∙∙∙∙∙∙∙∙∙∙
    // ∙∙∙∙∙∙∙∙∙∙∙∙∙∙∙∙∙∙∙█∙∙∙██∙∙∙∙██∙∙∙█∙█████████████████████∙██████∙███████∙████████████████████∙∙∙∙██∙∙∙∙██∙∙∙█∙∙∙∙∙∙∙∙∙∙∙∙∙∙∙∙∙∙∙
    // ∙∙∙∙∙∙∙∙∙∙∙∙∙∙∙∙∙∙∙█∙∙∙██∙∙∙∙██∙∙∙█∙█████████████████████∙██████∙███████∙████████████████████∙∙∙∙██∙∙∙∙██∙∙∙█∙∙∙∙∙∙∙∙∙∙∙∙∙∙∙∙∙∙∙
    // ∙∙∙∙∙∙∙∙∙∙∙∙∙∙∙∙∙∙∙█∙∙∙∙∙∙∙∙∙∙∙∙∙∙█∙█████████████████████∙██████∙∙██████∙████████████████████∙∙∙∙∙∙∙∙∙∙∙∙∙∙∙█∙∙∙∙∙∙∙∙∙∙∙∙∙∙∙∙∙∙∙
    // ∙∙∙∙∙∙∙∙∙∙∙∙∙∙∙∙∙∙∙███∙∙∙∙██∙∙∙∙███∙█████████████████████∙██████████████∙████████████████████∙██∙∙∙∙██∙∙∙∙███∙∙∙∙∙∙∙∙∙∙∙∙∙∙∙∙∙∙∙
    // ∙∙∙∙∙∙∙∙∙∙∙∙∙∙∙∙∙∙∙███∙∙∙∙██∙∙∙∙███∙█████████████████████∙██∙∙∙∙∙∙∙∙████∙████████████████████∙██∙∙∙∙██∙∙∙∙███∙∙∙∙∙∙∙∙∙∙∙∙∙∙∙∙∙∙∙
    // ∙∙∙∙∙∙∙∙∙∙∙∙∙∙∙∙∙∙∙█∙∙∙██∙∙∙∙██∙∙∙█∙█████████████████████∙██████████████∙████████████████████∙∙∙∙██∙∙∙∙██∙∙∙█∙∙∙∙∙∙∙∙∙∙∙∙∙∙∙∙∙∙∙
    // ∙∙∙∙∙∙∙∙∙∙∙∙∙∙∙∙∙∙∙█∙∙∙██∙∙∙∙██∙∙∙█∙█████████████████████∙███████∙██████∙████████████████████∙∙∙∙██∙∙∙∙██∙∙∙█∙∙∙∙∙∙∙∙∙∙∙∙∙∙∙∙∙∙∙
    // ∙∙∙∙∙∙∙∙∙∙∙∙∙∙∙∙∙∙∙█∙∙∙∙∙∙∙∙∙∙∙∙∙∙█∙█████████████████████∙███████∙██████∙████████████████████∙∙∙∙∙∙∙∙∙∙∙∙∙∙∙█∙∙∙∙∙∙∙∙∙∙∙∙∙∙∙∙∙∙∙
    // ∙∙∙∙∙∙∙∙∙∙∙∙∙∙∙∙∙∙∙███∙∙∙∙██∙∙∙∙███∙█████████████████████∙∙∙∙∙∙∙∙∙∙∙∙∙∙∙∙████████████████████∙██∙∙∙∙██∙∙∙∙███∙∙∙∙∙∙∙∙∙∙∙∙∙∙∙∙∙∙∙
    // ∙∙∙∙∙∙∙∙∙∙∙∙∙∙∙∙∙∙∙███∙∙∙∙██∙∙∙∙███∙█████████████████████████████████████████████████████████∙██∙∙∙∙██∙∙∙∙███∙∙∙∙∙∙∙∙∙∙∙∙∙∙∙∙∙∙∙
    // ∙∙∙∙∙∙∙∙∙∙∙∙∙∙∙∙∙∙∙█∙∙∙█∙∙∙∙∙∙█∙∙∙█∙█████████████████∙███∙███████████████∙∙██████████████████∙∙∙∙█∙∙∙∙∙∙█∙∙∙█∙∙∙∙∙∙∙∙∙∙∙∙∙∙∙∙∙∙∙
    // ∙∙∙∙∙∙∙∙∙∙∙∙∙∙∙∙∙∙∙█∙∙∙██∙∙∙∙██∙∙∙█∙█████████████████∙███∙███████∙█∙███∙█████████████████████∙∙∙∙██∙∙∙∙██∙∙∙█∙∙∙∙∙∙∙∙∙∙∙∙∙∙∙∙∙∙∙
    // ∙∙∙∙∙∙∙∙∙∙∙∙∙∙∙∙∙∙∙█∙∙∙∙∙∙∙∙∙∙∙∙∙∙█∙██████████████████∙██∙█∙∙███∙██∙███∙█∙███████████████████∙∙∙∙∙∙∙∙∙∙∙∙∙∙∙█∙∙∙∙∙∙∙∙∙∙∙∙∙∙∙∙∙∙∙
    // ∙∙∙∙∙∙∙∙∙∙∙∙∙∙∙∙∙∙∙███∙∙∙∙██∙∙∙∙███∙██████████████████∙██∙████∙████∙███∙██∙██████████████████∙██∙∙∙∙██∙∙∙∙███∙∙∙∙∙∙∙∙∙∙∙∙∙∙∙∙∙∙∙
    // ∙∙∙∙∙∙∙∙∙∙∙∙∙∙∙∙∙∙∙███∙∙∙∙██∙∙∙∙███∙███████████████████∙█∙██∙█∙████∙███∙███∙█████████████████∙██∙∙∙∙██∙∙∙∙███∙∙∙∙∙∙∙∙∙∙∙∙∙∙∙∙∙∙∙
    // ∙∙∙∙∙∙∙∙∙∙∙∙∙∙∙∙∙∙∙█∙∙∙∙∙∙∙∙∙∙∙∙∙∙█∙█████████████████∙█∙█∙█∙██∙████∙████∙██∙█████████████████∙∙∙∙∙∙∙∙∙∙∙∙∙∙∙█∙∙∙∙∙∙∙∙∙∙∙∙∙∙∙∙∙∙∙
    // ∙∙∙∙∙∙∙∙∙∙∙∙∙∙∙∙∙∙∙█∙∙∙██∙∙∙∙██∙∙∙█∙█████████████████∙█████∙█∙█∙█████████∙███████████████████∙∙∙∙██∙∙∙∙██∙∙∙█∙∙∙∙∙∙∙∙∙∙∙∙∙∙∙∙∙∙∙
    // ∙∙∙∙∙∙∙∙∙∙∙∙∙∙∙∙∙∙∙█∙∙∙█∙∙∙∙∙∙█∙∙∙█∙█████████████████████████████████████████████████████████∙∙∙∙█∙∙∙∙∙∙█∙∙∙█∙∙∙∙∙∙∙∙∙∙∙∙∙∙∙∙∙∙∙
    // ∙∙∙∙∙∙∙∙∙∙∙∙∙∙∙∙∙∙∙███∙∙∙∙██∙∙∙∙███∙█████████████████████████████████████████████████████████∙██∙∙∙∙██∙∙∙∙███∙∙∙∙∙∙∙∙∙∙∙∙∙∙∙∙∙∙∙
    // ∙∙∙∙∙∙∙∙∙∙∙∙∙∙∙∙∙∙∙███∙∙∙∙██∙∙∙∙███∙█████████████████████████████████████████████████████████∙██∙∙∙∙██∙∙∙∙███∙∙∙∙∙∙∙∙∙∙∙∙∙∙∙∙∙∙∙
    // ∙∙∙∙∙∙∙∙∙∙∙∙∙∙∙∙∙∙∙█∙∙∙∙∙∙∙∙∙∙∙∙∙∙█∙█████████████████████████████████████████████████████████∙∙∙∙∙∙∙∙∙∙∙∙∙∙∙█∙∙∙∙∙∙∙∙∙∙∙∙∙∙∙∙∙∙∙
    // ∙∙∙∙∙∙∙∙∙∙∙∙∙∙∙∙∙∙∙█∙∙∙██∙∙∙∙██∙∙∙█∙███████████████████████∙█∙██∙███∙████████████████████████∙∙∙∙██∙∙∙∙██∙∙∙█∙∙∙∙∙∙∙∙∙∙∙∙∙∙∙∙∙∙∙
    // ∙∙∙∙∙∙∙∙∙∙∙∙∙∙∙∙∙∙∙█∙∙∙██∙∙∙∙██∙∙∙█∙█████████████████████████████∙██∙████████████████████████∙∙∙∙██∙∙∙∙██∙∙∙█∙∙∙∙∙∙∙∙∙∙∙∙∙∙∙∙∙∙∙
    // ∙∙∙∙∙∙∙∙∙∙∙∙∙∙∙∙∙∙∙███∙∙∙∙██∙∙∙∙███∙█████████████████████████████████████████████████████████∙██∙∙∙∙██∙∙∙∙███∙∙∙∙∙∙∙∙∙∙∙∙∙∙∙∙∙∙∙
    // ∙∙∙∙∙∙∙∙∙∙∙∙∙∙∙∙∙∙∙███∙∙∙∙██∙∙∙∙███∙█████████████████████████████████████████████████████████∙██∙∙∙∙██∙∙∙∙███∙∙∙∙∙∙∙∙∙∙∙∙∙∙∙∙∙∙∙
    // ∙∙∙∙∙∙∙∙∙∙∙∙∙∙∙∙∙∙∙█∙∙∙∙∙∙∙∙∙∙∙∙∙∙█∙██████████████∙∙∙∙∙∙∙∙∙∙∙∙∙∙∙∙∙∙∙∙∙∙█████████████████████∙∙∙∙∙∙∙∙∙∙∙∙∙∙∙█∙∙∙∙∙∙∙∙∙∙∙∙∙∙∙∙∙∙∙
    // ∙∙∙∙∙∙∙∙∙∙∙∙∙∙∙∙∙∙∙█∙∙∙██∙∙∙∙██∙∙∙█∙██████████████∙∙∙∙∙∙∙∙∙∙∙∙∙∙∙∙∙∙∙∙∙∙█████████████████████∙∙∙∙██∙∙∙∙██∙∙∙█∙∙∙∙∙∙∙∙∙∙∙∙∙∙∙∙∙∙∙
    // ∙∙∙∙∙∙∙∙∙∙∙∙∙∙∙∙∙∙∙█∙∙∙██∙∙∙∙██∙∙∙█∙█████████████████████████████████████████████████████████∙∙∙∙██∙∙∙∙██∙∙∙█∙∙∙∙∙∙∙∙∙∙∙∙∙∙∙∙∙∙∙
    // ∙∙∙∙∙∙∙∙∙∙∙∙∙∙∙∙∙∙∙███∙∙∙∙██∙∙∙∙███∙█████████████████████████████████████████████████████████∙██∙∙∙∙██∙∙∙∙███∙∙∙∙∙∙∙∙∙∙∙∙∙∙∙∙∙∙∙
    // ∙∙∙∙∙∙∙∙∙∙∙∙∙∙∙∙∙∙∙███∙∙∙∙██∙∙∙∙███∙█████████████████████████████████████████████████████████∙██∙∙∙∙██∙∙∙∙███∙∙∙∙∙∙∙∙∙∙∙∙∙∙∙∙∙∙∙
    // ∙∙∙∙∙∙∙∙∙∙∙∙∙∙∙∙∙∙∙█∙∙∙∙∙∙∙∙∙∙∙∙∙∙█∙∙∙∙∙∙∙∙∙∙∙∙∙∙∙∙∙∙∙∙∙∙∙∙∙∙∙∙∙∙∙∙∙∙∙∙∙∙∙∙∙∙∙∙∙∙∙∙∙∙∙∙∙∙∙∙∙∙█∙∙∙∙∙∙∙∙∙∙∙∙∙∙█∙∙∙∙∙∙∙∙∙∙∙∙∙∙∙∙∙∙∙
    // ∙∙∙∙∙∙∙∙∙∙∙∙∙∙∙∙∙∙∙█∙∙∙██∙∙∙∙██∙∙∙███∙∙∙███∙∙███∙∙∙███∙∙∙███∙∙████∙∙███∙∙∙███∙∙∙███∙∙███∙∙∙███∙∙∙██∙∙∙∙██∙∙∙█∙∙∙∙∙∙∙∙∙∙∙∙∙∙∙∙∙∙∙
    // ∙∙∙∙∙∙∙∙∙∙∙∙∙∙∙∙∙∙∙█∙∙∙██∙∙∙∙██∙∙∙███∙∙∙██∙∙∙∙██∙∙∙███∙∙∙██∙∙∙∙██∙∙∙∙██∙∙∙███∙∙∙██∙∙∙∙██∙∙∙███∙∙∙██∙∙∙∙██∙∙∙█∙∙∙∙∙∙∙∙∙∙∙∙∙∙∙∙∙∙∙
    // ∙∙∙∙∙∙∙∙∙∙∙∙∙∙∙∙∙∙∙█∙∙∙∙∙∙∙∙∙∙∙∙∙∙∙∙∙∙∙∙∙∙∙∙∙∙∙∙∙∙∙∙∙∙∙∙∙∙∙∙∙∙∙∙∙∙∙∙∙∙∙∙∙∙∙∙∙∙∙∙∙∙∙∙∙∙∙∙∙∙∙∙∙∙∙∙∙∙∙∙∙∙∙∙∙∙∙∙█∙∙∙∙∙∙∙∙∙∙∙∙∙∙∙∙∙∙∙
    // ∙∙∙∙∙∙∙∙∙∙∙∙∙∙∙∙∙∙∙███∙∙∙∙██∙∙∙∙██∙∙∙██∙∙∙∙██∙∙∙∙██∙∙∙███∙∙∙██∙∙∙∙██∙∙∙███∙∙∙██∙∙∙∙██∙∙∙∙██∙∙∙██∙∙∙∙██∙∙∙∙███∙∙∙∙∙∙∙∙∙∙∙∙∙∙∙∙∙∙∙
    // ∙∙∙∙∙∙∙∙∙∙∙∙∙∙∙∙∙∙∙█∙∙∙∙∙∙∙∙∙∙∙∙∙∙∙∙∙∙∙∙∙∙∙∙∙∙∙∙∙∙∙∙∙∙∙∙∙∙∙∙∙∙∙∙∙∙∙∙∙∙∙∙∙∙∙∙∙∙∙∙∙∙∙∙∙∙∙∙∙∙∙∙∙∙∙∙∙∙∙∙∙∙∙∙∙∙∙∙█∙∙∙∙∙∙∙∙∙∙∙∙∙∙∙∙∙∙∙
    // ∙∙∙∙∙∙∙∙∙∙∙∙∙∙∙∙∙∙∙█∙∙∙██∙∙∙∙██∙∙∙███∙∙∙██∙∙∙∙██∙∙∙███∙∙∙██∙∙∙∙██∙∙∙∙██∙∙∙███∙∙∙██∙∙∙∙██∙∙∙███∙∙∙██∙∙∙∙██∙∙∙█∙∙∙∙∙∙∙∙∙∙∙∙∙∙∙∙∙∙∙
    // ∙∙∙∙∙∙∙∙∙∙∙∙∙∙∙∙∙∙∙█∙∙∙██∙∙∙∙██∙∙∙███∙∙∙██∙∙∙∙██∙∙∙███∙∙∙██∙∙∙∙██∙∙∙∙██∙∙∙███∙∙∙██∙∙∙∙██∙∙∙███∙∙∙██∙∙∙∙██∙∙∙█∙∙∙∙∙∙∙∙∙∙∙∙∙∙∙∙∙∙∙
    // ∙∙∙∙∙∙∙∙∙∙∙∙∙∙∙∙∙∙∙█∙∙∙∙∙∙∙∙∙∙∙∙∙∙∙∙∙∙∙∙∙∙∙∙∙∙∙∙∙∙∙∙∙∙∙∙∙∙∙∙∙∙∙∙∙∙∙∙∙∙∙∙∙∙∙∙∙∙∙∙∙∙∙∙∙∙∙∙∙∙∙∙∙∙∙∙∙∙∙∙∙∙∙∙∙∙∙█∙∙∙∙∙∙∙∙∙∙∙∙∙∙∙∙∙∙∙∙
    // ∙∙∙∙∙∙∙∙∙∙∙∙∙∙∙∙∙∙∙███∙∙∙∙██∙∙∙∙██∙∙∙██∙∙∙∙██∙∙∙∙██∙∙∙███∙∙∙██∙∙∙∙██∙∙∙███∙∙∙██∙∙∙∙██∙∙∙∙██∙∙∙██∙∙∙∙██∙∙∙∙███∙∙∙∙∙∙∙∙∙∙∙∙∙∙∙∙∙∙∙
    // ∙∙∙∙∙∙∙∙∙∙∙∙∙∙∙∙∙∙∙███∙∙∙∙██∙∙∙∙██∙∙∙██∙∙∙∙██∙∙∙∙██∙∙∙███∙∙∙██∙∙∙∙██∙∙∙∙██∙∙∙██∙∙∙∙██∙∙∙∙██∙∙∙██∙∙∙∙██∙∙∙∙███∙∙∙∙∙∙∙∙∙∙∙∙∙∙∙∙∙∙∙
    // ∙∙∙∙∙∙∙∙∙∙∙∙∙∙∙∙∙∙∙█∙∙∙██∙∙∙∙██∙∙∙███∙∙∙██∙∙∙∙██∙∙∙███∙∙∙██∙∙∙∙██∙∙∙∙██∙∙∙███∙∙∙██∙∙∙∙██∙∙∙███∙∙∙██∙∙∙∙██∙∙∙█∙∙∙∙∙∙∙∙∙∙∙∙∙∙∙∙∙∙∙
    // ∙∙∙∙∙∙∙∙∙∙∙∙∙∙∙∙∙∙∙█∙∙∙██∙∙∙∙██∙∙∙███∙∙∙██∙∙∙∙██∙∙∙███∙∙∙██∙∙∙∙██∙∙∙∙██∙∙∙███∙∙∙██∙∙∙∙██∙∙∙███∙∙∙██∙∙∙∙██∙∙∙█∙∙∙∙∙∙∙∙∙∙∙∙∙∙∙∙∙∙∙
    // ∙∙∙∙∙∙∙∙∙∙∙∙∙∙∙∙∙∙∙██████████████████████████████████████████████████████████████████████████████████████████∙∙∙∙∙∙∙∙∙∙∙∙∙∙∙∙∙∙∙
    // ∙∙∙∙∙∙∙∙∙∙∙∙∙∙∙∙∙∙∙∙∙∙∙∙∙∙∙∙∙∙∙∙∙∙∙∙∙∙∙∙∙∙∙∙∙∙∙∙∙∙∙∙∙∙∙∙∙∙∙∙∙∙∙∙∙∙∙∙∙∙∙∙∙∙∙∙∙∙∙∙∙∙∙∙∙∙∙∙∙∙∙∙∙∙∙∙∙∙∙∙∙∙∙∙∙∙∙∙∙∙∙∙∙∙∙∙∙∙∙∙∙∙∙∙∙∙∙∙
    // ∙∙∙∙∙∙∙∙∙∙∙∙∙∙∙∙∙∙∙∙∙∙∙∙∙∙∙∙∙∙∙∙∙∙∙∙∙∙∙∙∙∙∙∙∙∙∙∙∙∙∙∙∙∙∙∙∙∙∙∙∙∙∙∙∙∙∙∙∙∙∙∙∙∙∙∙∙∙∙∙∙∙∙∙∙∙∙∙∙∙∙∙∙∙∙∙∙∙∙∙∙∙∙∙∙∙∙∙∙∙∙∙∙∙∙∙∙∙∙∙∙∙∙∙∙∙∙∙
    0x00, 0x00, 0x00, 0x00, 0x00, 0x00, 0x00, 0x00, 0x00, 0x00, 0x00, 0x00, 0x00, 0x00, 0x00, 0x00, 
    0x00, 0x00, 0x00, 0x00, 0x00, 0x00, 0x00, 0x00, 0x00, 0x00, 0x00, 0x00, 0x00, 0x00, 0x00, 0x00, 
    0x00, 0x00, 0x1f, 0xff, 0xff, 0xff, 0xff, 0xff, 0xff, 0xff, 0xff, 0xff, 0xff, 0xf8, 0x00, 0x00, 
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    0x00, 0x00, 0x00, 0x00, 0x00, 0x00, 0x00, 0x00, 0x00, 0x00, 0x00, 0x00, 0x00, 0x00, 0x00, 0x00
};
static const uint8_t image_data_desk[1024] = {
    // ██∙∙∙███∙████∙█████████∙∙█████∙∙∙█∙∙∙███∙∙█████████∙∙██∙∙████████∙∙██∙∙█████████████████████████████████████████████∙∙∙∙███∙██∙█
    // █∙██∙███∙∙∙██∙█∙███████∙∙∙███∙∙∙∙██∙∙∙███∙∙██████∙∙∙∙█∙∙███████∙█∙∙██∙██████████████████████████████████████████████∙██∙█∙█∙██∙█
    // █∙██∙█████∙█∙∙∙█∙████████∙∙∙██∙∙∙∙███∙█∙∙∙∙██████∙∙█∙∙█∙██████∙█∙█∙█∙███████████████████████████████████████████████∙∙∙∙███∙██∙█
    // █∙███∙███∙∙∙∙∙∙∙∙█████∙∙∙∙∙∙██∙∙∙∙█████∙∙█∙██████∙∙∙∙∙█∙███████∙██∙∙█∙█████████████████████████████████████████████████∙█∙█∙██∙█
    // ██∙∙∙███████∙██∙∙██████████∙█████∙∙█████∙██████████∙███████████∙∙███████████████████████████████████████████████████∙∙∙∙███∙██∙█
    // ∙∙∙∙∙∙∙∙∙∙∙∙∙∙∙∙∙∙∙∙∙∙∙∙∙∙∙∙∙∙∙∙∙∙∙∙∙∙∙∙∙∙∙∙∙∙∙∙∙∙∙∙∙∙∙∙∙∙∙∙∙∙∙∙∙∙∙∙∙∙∙∙∙∙∙∙∙∙∙∙∙∙∙∙∙∙∙∙∙∙∙∙∙∙∙∙∙∙∙∙∙∙∙∙∙∙∙∙∙∙∙∙∙∙∙∙∙∙∙∙∙∙∙∙∙∙∙∙
    // █∙█∙█∙█∙█∙█∙█∙█∙█∙█∙█∙█∙█∙█∙█∙█∙█∙█∙█∙█∙█∙█∙█∙█∙█∙█∙█∙█∙█∙█∙█∙█∙█∙█∙█∙█∙█∙█∙█∙█∙█∙█∙█∙█∙█∙█∙█∙█∙█∙█∙█∙█∙█∙█∙█∙█∙█∙█∙█∙█∙█∙█∙█∙█∙
    // ∙█∙█∙█∙█∙█∙█∙█∙█∙█∙█∙█∙█∙█∙█∙█∙█∙█∙█∙█∙█∙█∙█∙█∙█∙█∙█∙█∙█∙█∙█∙█∙█∙█∙█∙█∙█∙█∙█∙█∙█∙█∙█∙█∙█∙█∙█∙█∙█∙█∙█∙█∙█∙█∙█∙█∙█∙█∙█∙█∙█∙█∙█∙█∙█
    // █∙█∙█∙█∙█∙█∙█∙█∙█∙█∙█∙█∙█∙█∙█∙█∙█∙█∙█∙█∙█∙█∙█∙█∙█∙█∙█∙█∙█∙█∙█∙█∙█∙█∙█∙█∙█∙█∙█∙█∙█∙█∙█∙█∙█∙█∙█∙█∙█∙█∙█∙█∙█∙█∙█∙█∙█∙█∙█∙∙∙∙∙∙∙∙∙█∙
    // ∙█∙█∙█∙█∙█∙█∙█∙█∙█∙█∙█∙█∙█∙█∙█∙█∙█∙█∙█∙█∙█∙█∙█∙█∙█∙█∙█∙█∙█∙█∙█∙█∙█∙█∙█∙█∙█∙█∙█∙█∙█∙█∙█∙█∙█∙█∙█∙█∙█∙█∙█∙█∙█∙█∙█∙█∙█∙█∙∙███████∙∙█
    // █∙█∙█∙█∙█∙█∙█∙█∙█∙█∙█∙█∙█∙█∙█∙█∙█∙█∙█∙█∙█∙█∙█∙█∙█∙█∙█∙█∙█∙█∙█∙█∙█∙█∙█∙█∙█∙█∙█∙█∙█∙█∙█∙█∙█∙█∙█∙█∙█∙█∙█∙█∙█∙█∙█∙█∙█∙█∙█∙█∙█████∙█∙
    // ∙█∙█∙█∙█∙█∙█∙█∙█∙█∙█∙█∙█∙█∙█∙█∙█∙█∙█∙█∙█∙█∙█∙█∙█∙█∙█∙█∙█∙█∙█∙█∙█∙█∙█∙█∙█∙█∙█∙█∙█∙█∙█∙█∙█∙█∙█∙█∙█∙█∙█∙█∙█∙█∙█∙█∙█∙█∙█∙∙∙∙∙∙∙∙∙∙∙█
    // █∙█∙█∙█∙█∙█∙█∙█∙█∙█∙█∙█∙█∙█∙█∙█∙█∙█∙█∙█∙█∙█∙█∙█∙█∙█∙█∙█∙█∙█∙█∙█∙█∙█∙█∙█∙█∙█∙█∙█∙█∙█∙█∙█∙█∙█∙█∙█∙█∙█∙█∙█∙█∙█∙█∙█∙█∙█∙█∙█∙█∙█∙█∙█∙
    // ∙█∙█∙█∙█∙█∙█∙█∙█∙█∙█∙█∙█∙█∙█∙█∙█∙█∙█∙█∙█∙█∙█∙█∙█∙█∙█∙█∙█∙█∙█∙█∙█∙█∙█∙█∙█∙█∙█∙█∙█∙█∙█∙█∙█∙█∙█∙█∙█∙█∙█∙█∙█∙█∙█∙█∙█∙█∙█∙█∙█∙█∙█∙█∙█
    // █∙█∙█∙█∙█∙█∙█∙█∙█∙█∙█∙█∙█∙█∙█∙█∙█∙█∙█∙█∙█∙█∙█∙█∙█∙█∙█∙█∙█∙█∙█∙█∙█∙█∙█∙█∙█∙█∙█∙█∙█∙█∙█∙█∙█∙█∙█∙█∙█∙█∙█∙█∙█∙█∙█∙█∙█∙█∙█∙█∙█∙█∙█∙█∙
    // ∙█∙█∙█∙█∙█∙█∙█∙█∙█∙█∙█∙█∙█∙█∙█∙█∙█∙█∙█∙█∙█∙█∙█∙█∙█∙█∙█∙█∙█∙█∙█∙█∙█∙█∙█∙█∙█∙█∙█∙█∙█∙█∙█∙█∙█∙█∙█∙█∙█∙█∙█∙█∙█∙█∙█∙█∙█∙█∙∙∙∙∙∙∙∙∙∙∙█
    // █∙█∙█∙█∙█∙█∙█∙█∙█∙█∙█∙█∙█∙█∙█∙█∙█∙█∙█∙█∙█∙█∙█∙█∙█∙█∙█∙█∙█∙█∙█∙█∙█∙█∙█∙█∙█∙█∙█∙█∙█∙█∙█∙█∙█∙█∙█∙█∙█∙█∙█∙█∙█∙█∙█∙█∙█∙█∙█∙███████∙█∙
    // ∙█∙█∙█∙█∙█∙█∙█∙█∙█∙█∙█∙█∙█∙█∙█∙█∙█∙█∙█∙█∙█∙█∙█∙█∙█∙█∙█∙█∙█∙█∙█∙█∙█∙█∙█∙█∙█∙█∙█∙█∙█∙█∙█∙█∙█∙█∙█∙█∙█∙█∙█∙█∙█∙█∙█∙█∙█∙█∙∙█∙█████∙∙█
    // █∙█∙█∙█∙█∙█∙█∙█∙█∙█∙█∙█∙█∙█∙█∙█∙█∙█∙█∙█∙█∙█∙█∙█∙█∙█∙█∙█∙█∙█∙█∙█∙█∙█∙█∙█∙█∙█∙█∙█∙█∙█∙█∙█∙█∙█∙█∙█∙█∙█∙█∙█∙█∙█∙█∙█∙█∙█∙█∙∙∙∙∙∙∙∙∙█∙
    // ∙█∙█∙█∙█∙█∙█∙█∙█∙█∙█∙█∙█∙█∙█∙█∙█∙█∙∙∙∙∙∙∙∙∙∙∙∙∙∙∙∙∙∙∙∙∙∙∙∙∙∙∙∙∙∙∙∙∙∙∙∙∙∙∙∙∙∙∙∙∙∙∙∙∙∙∙∙∙∙∙∙∙∙∙∙∙█∙█∙█∙█∙█∙█∙█∙█∙█∙█∙█∙█∙█∙█∙█∙█∙█
    // █∙█∙█∙█∙█∙█∙█∙█∙█∙█∙█∙█∙█∙█∙█∙█∙█∙█∙███∙█∙█∙███∙█∙█∙███∙█∙█∙███∙█∙█∙███∙█∙█∙███∙█∙█∙███∙█∙█∙█∙█∙█∙█∙█∙█∙█∙█∙█∙█∙█∙█∙█∙█∙█∙█∙█∙█∙
    // ∙█∙█∙█∙█∙█∙█∙█∙█∙█∙█∙█∙█∙█∙█∙█∙█∙█∙∙∙∙∙∙∙█∙█∙█∙█∙█∙█∙█∙█∙█∙█∙█∙█∙█∙█∙█∙█∙█∙█∙█∙█∙█∙█∙█∙█∙∙∙∙∙∙∙█∙█∙█∙█∙█∙█∙█∙█∙█∙█∙█∙█∙█∙█∙█∙█∙█
    // █∙█∙█∙█∙█∙█∙█∙█∙█∙█∙█∙█∙█∙█∙█∙█∙█∙█∙█∙∙∙█∙█∙█∙█∙█∙█∙█∙█∙█∙█∙█∙█∙█∙█∙█∙█∙█∙█∙█∙█∙█∙█∙█∙█∙█∙∙∙█∙█∙█∙█∙█∙█∙█∙█∙█∙█∙█∙█∙█∙█∙█∙█∙█∙█∙
    // ∙█∙█∙█∙█∙█∙█∙█∙█∙█∙█∙█∙█∙█∙█∙█∙█∙█∙∙∙∙∙∙∙∙∙∙∙∙∙∙∙∙∙∙∙∙∙∙∙∙∙∙∙∙∙∙∙∙∙∙∙∙∙∙∙∙∙∙∙∙∙∙∙∙∙∙∙∙∙∙∙∙∙∙∙∙∙█∙█∙█∙█∙█∙█∙█∙█∙█∙█∙█∙█∙█∙∙∙∙∙∙∙█
    // █∙█∙█∙█∙█∙█∙█∙█∙█∙█∙█∙█∙█∙█∙█∙█∙█∙█∙∙∙∙█∙∙∙█∙∙∙██████████████████████████████████████████████∙█∙█∙█∙█∙█∙█∙█∙█∙█∙█∙█∙█∙█∙∙∙█∙█∙█∙
    // ∙█∙█∙█∙█∙█∙█∙█∙█∙█∙█∙█∙█∙█∙█∙█∙█∙█∙∙████∙███∙██∙█████████████████████████████████████████████∙∙█∙█∙█∙█∙█∙█∙█∙█∙█∙█∙█∙█∙█∙█∙█∙∙∙█
    // █∙█∙█∙█∙█∙█∙█∙█∙█∙█∙█∙█∙█∙█∙█∙█∙█∙█∙∙████∙█∙███∙█████████████████████████████████████████████∙█∙█∙█∙█∙█∙█∙█∙█∙█∙█∙█∙█∙█∙∙∙█∙█∙█∙
    // ∙█∙█∙█∙█∙█∙█∙█∙█∙█∙█∙█∙█∙█∙█∙█∙█∙█∙∙████∙∙∙∙∙██∙█████████████████████████████████████████████∙∙█∙█∙█∙█∙█∙█∙█∙█∙█∙█∙█∙█∙█∙∙∙∙∙∙∙█
    // █∙█∙█∙█∙█∙█∙█∙█∙█∙█∙█∙█∙█∙█∙█∙█∙█∙█∙∙██∙∙█∙█∙∙███████████████████████████████████████████████∙█∙█∙█∙█∙█∙█∙█∙█∙█∙█∙█∙█∙█∙∙██∙∙∙█∙
    // ∙█∙█∙█∙█∙█∙█∙█∙█∙█∙█∙█∙█∙█∙█∙█∙█∙█∙∙██∙∙∙∙∙∙∙∙∙∙█████████████████████████████████████████████∙∙█∙█∙█∙█∙█∙█∙█∙█∙█∙█∙█∙█∙█∙████∙∙█
    // █∙█∙█∙█∙█∙█∙█∙█∙█∙█∙█∙█∙█∙█∙█∙█∙█∙█∙∙█∙█∙∙∙∙∙█∙∙█████████████████████████████████████████████∙█∙█∙█∙█∙█∙█∙█∙█∙█∙█∙█∙█∙█∙∙∙∙∙∙∙█∙
    // ∙█∙█∙█∙█∙█∙█∙█∙█∙█∙█∙█∙█∙█∙█∙█∙█∙█∙∙████∙███∙██∙█████████████████████████████████████████████∙∙█∙█∙█∙█∙█∙█∙█∙█∙█∙█∙█∙█∙█∙█∙█∙█∙█
    // █∙█∙█∙█∙█∙█∙█∙█∙█∙█∙█∙█∙█∙█∙█∙█∙█∙█∙∙███∙∙█∙∙██∙∙∙∙∙∙∙███████████████████████████████████████∙█∙█∙█∙█∙█∙█∙█∙█∙█∙█∙█∙█∙█∙█∙█∙█∙█∙
    // ∙█∙█∙█∙█∙█∙█∙█∙█∙█∙█∙█∙█∙█∙█∙█∙█∙█∙∙█∙█∙█∙█∙█∙█∙∙∙∙∙∙████████████████████████████████████████∙∙█∙█∙█∙█∙█∙█∙█∙█∙█∙█∙█∙█∙█∙█∙█∙█∙█
    // █∙█∙█∙█∙█∙█∙█∙█∙█∙█∙█∙█∙█∙█∙█∙█∙█∙█∙████████████∙∙∙∙∙████████████████████████████████████████∙█∙█∙█∙█∙█∙█∙█∙█∙█∙█∙█∙█∙█∙█∙█∙█∙█∙
    // ∙█∙█∙█∙█∙█∙█∙█∙█∙█∙█∙█∙█∙█∙█∙█∙█∙█∙∙█████████████∙∙█∙∙███████████████████████████████████████∙∙█∙█∙█∙█∙█∙█∙█∙█∙█∙█∙█∙█∙█∙█∙█∙█∙█
    // █∙█∙█∙█∙█∙█∙█∙█∙█∙█∙█∙█∙█∙█∙█∙█∙█∙█∙█████████████████∙███████████████████████████████████████∙█∙█∙█∙█∙█∙█∙█∙█∙█∙█∙█∙█∙█∙█∙█∙█∙█∙
    // ∙█∙█∙█∙█∙█∙█∙█∙█∙█∙█∙█∙█∙█∙█∙█∙█∙█∙∙█████████████████████████████████████████████████████████∙∙█∙█∙█∙█∙█∙█∙█∙█∙█∙█∙█∙█∙█∙█∙█∙█∙█
    // █∙█∙█∙█∙█∙█∙█∙█∙█∙█∙█∙█∙█∙█∙█∙█∙█∙█∙█████████████████████████████████████████████████████████∙█∙█∙█∙█∙█∙█∙█∙█∙█∙█∙█∙█∙█∙█∙█∙█∙█∙
    // ∙█∙█∙█∙█∙█∙█∙█∙█∙█∙█∙█∙█∙█∙█∙█∙█∙█∙∙█████████████████████████████████████████████████████████∙∙█∙█∙█∙█∙█∙█∙█∙█∙█∙█∙█∙█∙█∙█∙█∙█∙█
    // █∙█∙█∙█∙█∙█∙█∙█∙█∙█∙█∙█∙█∙█∙█∙█∙█∙█∙█████████████████████████████████████████████████████████∙█∙█∙█∙█∙█∙█∙█∙█∙█∙█∙█∙█∙█∙█∙█∙█∙█∙
    // ∙█∙█∙█∙█∙█∙█∙█∙█∙█∙█∙█∙█∙█∙█∙█∙█∙█∙∙█████████████████████████████████████████████████████████∙∙█∙█∙█∙█∙█∙█∙█∙█∙█∙█∙█∙█∙█∙█∙█∙█∙█
    // █∙█∙█∙█∙█∙█∙█∙█∙█∙█∙█∙█∙█∙█∙█∙█∙█∙█∙█████████████████████████████████████████████████████████∙█∙█∙█∙█∙█∙█∙█∙█∙█∙█∙█∙█∙█∙█∙█∙█∙█∙
    // ∙█∙█∙█∙█∙█∙█∙█∙█∙█∙█∙█∙█∙█∙█∙█∙█∙█∙∙∙∙∙∙∙∙∙∙∙∙∙∙∙∙∙∙∙∙∙∙∙∙∙∙∙∙∙∙∙∙∙∙∙∙∙∙∙∙∙∙∙∙∙∙∙∙∙∙∙∙∙∙∙∙∙∙∙∙∙█∙█∙█∙█∙█∙█∙█∙█∙█∙█∙█∙█∙█∙█∙█∙█∙█
    // █∙█∙█∙█∙█∙█∙█∙█∙█∙█∙█∙█∙█∙█∙█∙█∙█∙█∙█∙█∙█∙█∙█∙█∙█∙█∙█∙█∙█∙█∙█∙█∙█∙█∙█∙█∙█∙█∙█∙█∙█∙█∙█∙█∙█∙█∙█∙█∙█∙█∙█∙█∙█∙█∙█∙█∙█∙█∙█∙█∙█∙█∙█∙█∙
    // ∙█∙█∙█∙█∙█∙█∙█∙█∙█∙█∙█∙█∙█∙█∙█∙█∙█∙█∙█∙█∙█∙█∙█∙█∙█∙█∙█∙█∙█∙█∙█∙█∙█∙█∙█∙█∙█∙█∙█∙█∙█∙█∙█∙█∙█∙█∙█∙█∙█∙█∙█∙█∙█∙█∙█∙█∙█∙█∙█∙█∙█∙█∙█∙█
    // █∙█∙█∙█∙█∙█∙█∙█∙█∙█∙█∙█∙█∙█∙█∙█∙█∙█∙█∙█∙█∙█∙█∙█∙█∙█∙█∙█∙█∙█∙█∙█∙█∙█∙█∙█∙█∙█∙█∙█∙█∙█∙█∙█∙█∙█∙█∙█∙█∙█∙█∙█∙█∙█∙█∙█∙█∙█∙█∙█∙█∙█∙█∙█∙
    // ∙█∙█∙█∙█∙█∙█∙█∙█∙█∙█∙█∙█∙█∙█∙█∙█∙█∙█∙█∙█∙█∙█∙█∙█∙█∙█∙█∙█∙█∙█∙█∙█∙█∙█∙█∙█∙█∙█∙█∙█∙█∙█∙█∙█∙█∙█∙█∙█∙█∙█∙█∙█∙█∙█∙█∙█∙█∙█∙█∙█∙█∙█∙█∙█
    // █∙█∙█∙█∙█∙█∙█∙█∙█∙█∙█∙█∙█∙█∙█∙█∙█∙█∙█∙█∙█∙█∙█∙█∙█∙█∙█∙█∙█∙█∙█∙█∙█∙█∙█∙█∙█∙█∙█∙█∙█∙█∙█∙█∙█∙█∙█∙█∙█∙█∙█∙█∙█∙█∙█∙█∙█∙█∙█∙█∙█∙█∙█∙█∙
    // ∙█∙█∙█∙█∙█∙█∙█∙█∙█∙█∙█∙█∙█∙█∙█∙█∙█∙█∙█∙█∙█∙█∙█∙█∙█∙█∙█∙█∙█∙█∙█∙█∙█∙█∙█∙█∙█∙█∙█∙█∙█∙█∙█∙█∙█∙█∙█∙█∙█∙█∙█∙█∙█∙█∙█∙█∙█∙█∙█∙█∙█∙█∙█∙█
    // █∙█∙█∙█∙█∙█∙█∙█∙█∙█∙█∙█∙█∙█∙█∙█∙█∙█∙█∙█∙█∙█∙█∙█∙█∙█∙█∙█∙█∙█∙█∙█∙█∙█∙█∙█∙█∙█∙█∙█∙█∙█∙█∙█∙█∙█∙█∙█∙█∙█∙█∙█∙█∙█∙█∙█∙█∙█∙█∙█∙█∙█∙█∙█∙
    // ∙█∙█∙█∙█∙█∙█∙█∙█∙█∙█∙█∙█∙█∙█∙█∙█∙█∙█∙█∙█∙█∙█∙█∙█∙█∙█∙█∙█∙█∙█∙█∙█∙█∙█∙█∙█∙█∙█∙█∙█∙█∙█∙█∙█∙█∙█∙█∙█∙█∙█∙█∙█∙█∙█∙█∙█∙█∙█∙█∙█∙█∙█∙█∙█
    // █∙█∙█∙█∙█∙█∙█∙█∙█∙█∙█∙█∙█∙█∙█∙█∙█∙█∙█∙█∙█∙█∙█∙█∙█∙█∙█∙█∙█∙█∙█∙█∙█∙█∙█∙█∙█∙█∙█∙█∙█∙█∙█∙█∙█∙█∙█∙█∙█∙█∙█∙█∙█∙█∙█∙█∙█∙█∙█∙█∙█∙█∙█∙█∙
    // ∙█∙█∙█∙█∙█∙█∙█∙█∙█∙█∙█∙█∙█∙█∙█∙█∙█∙█∙█∙█∙█∙█∙█∙█∙█∙█∙█∙█∙█∙█∙█∙█∙█∙█∙█∙█∙█∙█∙█∙█∙█∙█∙█∙█∙█∙█∙█∙█∙█∙█∙█∙█∙█∙█∙█∙█∙█∙█∙█∙█∙█∙█∙█∙█
    // █∙█∙█∙█∙█∙█∙█∙█∙█∙█∙█∙█∙█∙█∙█∙█∙█∙█∙█∙█∙█∙█∙█∙█∙█∙█∙█∙█∙█∙█∙█∙█∙█∙█∙█∙█∙█∙█∙█∙█∙█∙█∙█∙█∙█∙█∙█∙█∙█∙█∙█∙█∙█∙█∙█∙█∙█∙█∙█∙█∙█∙█∙█∙█∙
    // ∙█∙█∙█∙█∙█∙█∙█∙█∙█∙█∙█∙█∙█∙█∙█∙█∙█∙█∙█∙█∙█∙█∙█∙█∙█∙█∙█∙█∙█∙█∙█∙█∙█∙█∙█∙█∙█∙█∙█∙█∙█∙█∙█∙█∙█∙█∙█∙█∙█∙█∙█∙█∙█∙█∙█∙█∙█∙█∙█∙█∙█∙█∙█∙█
    // █∙█∙█∙█∙█∙█∙█∙█∙█∙█∙█∙█∙█∙█∙█∙█∙█∙█∙█∙█∙█∙█∙█∙█∙█∙█∙█∙█∙█∙█∙█∙█∙█∙█∙█∙█∙█∙█∙█∙█∙█∙█∙█∙█∙█∙█∙█∙█∙█∙█∙█∙█∙█∙█∙█∙█∙█∙█∙█∙█∙█∙∙∙█∙█∙
    // ∙█∙█∙█∙█∙█∙█∙█∙█∙█∙█∙█∙█∙█∙█∙█∙█∙█∙█∙█∙█∙█∙█∙█∙█∙█∙█∙█∙█∙█∙█∙█∙█∙█∙█∙█∙█∙█∙█∙█∙█∙█∙█∙█∙█∙█∙█∙█∙█∙█∙█∙█∙█∙█∙█∙█∙█∙█∙█∙█∙∙∙∙∙∙∙∙∙█
    // █∙█∙█∙█∙█∙█∙█∙█∙█∙█∙█∙█∙█∙█∙█∙█∙█∙█∙█∙█∙█∙█∙█∙█∙█∙█∙█∙█∙█∙█∙█∙█∙█∙█∙█∙█∙█∙█∙█∙█∙█∙█∙█∙█∙█∙█∙█∙█∙█∙█∙█∙█∙█∙█∙█∙█∙█∙█∙█∙█∙∙∙██∙∙█∙
    // ∙█∙█∙█∙█∙█∙█∙█∙█∙█∙█∙█∙█∙█∙█∙█∙█∙█∙█∙█∙█∙█∙█∙█∙█∙█∙█∙█∙█∙█∙█∙█∙█∙█∙█∙█∙█∙█∙█∙█∙█∙█∙█∙█∙█∙█∙█∙█∙█∙█∙█∙█∙█∙█∙█∙█∙█∙█∙█∙█∙█∙█∙█∙█∙█
    // █∙█∙█∙█∙█∙█∙█∙█∙█∙█∙█∙█∙█∙█∙█∙█∙█∙█∙█∙█∙█∙█∙█∙█∙█∙█∙█∙█∙█∙█∙█∙█∙█∙█∙█∙█∙█∙█∙█∙█∙█∙█∙█∙█∙█∙█∙█∙█∙█∙█∙█∙█∙█∙█∙█∙█∙█∙█∙█∙█∙∙██∙∙∙█∙
    // ∙█∙█∙█∙█∙█∙█∙█∙█∙█∙█∙█∙█∙█∙█∙█∙█∙█∙█∙█∙█∙█∙█∙█∙█∙█∙█∙█∙█∙█∙█∙█∙█∙█∙█∙█∙█∙█∙█∙█∙█∙█∙█∙█∙█∙█∙█∙█∙█∙█∙█∙█∙█∙█∙█∙█∙█∙█∙█∙█∙█∙█∙█∙█∙█
    // █∙█∙█∙█∙█∙█∙█∙█∙█∙█∙█∙█∙█∙█∙█∙█∙█∙█∙█∙█∙█∙█∙█∙█∙█∙█∙█∙█∙█∙█∙█∙█∙█∙█∙█∙█∙█∙█∙█∙█∙█∙█∙█∙█∙█∙█∙█∙█∙█∙█∙█∙█∙█∙█∙█∙█∙█∙█∙█∙█∙∙∙∙∙∙∙█∙
    // ∙█∙█∙█∙█∙█∙█∙█∙█∙█∙█∙█∙█∙█∙█∙█∙█∙█∙█∙█∙█∙█∙█∙█∙█∙█∙█∙█∙█∙█∙█∙█∙█∙█∙█∙█∙█∙█∙█∙█∙█∙█∙█∙█∙█∙█∙█∙█∙█∙█∙█∙█∙█∙█∙█∙█∙█∙█∙█∙█∙█∙█∙█∙█∙█
    0xc7, 0x7b, 0xfe, 0x7c, 0x47, 0x3f, 0xe6, 0x7f, 0x99, 0xff, 0xff, 0xff, 0xff, 0xff, 0xf0, 0xed, 
    0xb7, 0x1a, 0xfe, 0x38, 0x63, 0x9f, 0x84, 0xfe, 0x9b, 0xff, 0xff, 0xff, 0xff, 0xff, 0xf6, 0xad, 
    0xb7, 0xd1, 0x7f, 0x8c, 0x3a, 0x1f, 0x92, 0xfd, 0x57, 0xff, 0xff, 0xff, 0xff, 0xff, 0xf0, 0xed, 
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    0x55, 0x55, 0x55, 0x55, 0x55, 0x55, 0x55, 0x55, 0x55, 0x55, 0x55, 0x55, 0x55, 0x55, 0x55, 0x55
};
static const uint8_t image_data_bg[1024] = {
    // ∙∙∙█∙∙∙█∙∙∙█∙∙∙█∙∙∙█∙∙∙█∙∙∙█∙∙∙█∙∙∙█∙∙∙█∙∙∙█∙∙∙█∙∙∙█∙∙∙█∙∙∙█∙∙∙█∙∙∙█∙∙∙█∙∙∙█∙∙∙█∙∙∙█∙∙∙█∙∙∙█∙∙∙█∙∙∙█∙∙∙█∙∙∙█∙∙∙█∙∙∙█∙∙∙█∙∙∙█∙∙∙█
    // █∙█∙█∙█∙█∙█∙█∙█∙█∙█∙█∙█∙█∙█∙█∙█∙█∙█∙█∙█∙█∙█∙█∙█∙█∙█∙█∙█∙█∙█∙█∙█∙█∙█∙█∙█∙█∙█∙█∙█∙█∙█∙█∙█∙█∙█∙█∙█∙█∙█∙█∙█∙█∙█∙█∙█∙█∙█∙█∙█∙█∙█∙█∙█∙
    // ∙█∙∙∙█∙∙∙█∙∙∙█∙∙∙█∙∙∙█∙∙∙█∙∙∙█∙∙∙█∙∙∙█∙∙∙█∙∙∙█∙∙∙█∙∙∙█∙∙∙█∙∙∙█∙∙∙█∙∙∙█∙∙∙█∙∙∙█∙∙∙█∙∙∙█∙∙∙█∙∙∙█∙∙∙█∙∙∙█∙∙∙█∙∙∙█∙∙∙█∙∙∙█∙∙∙█∙∙∙█∙∙
    // ∙∙∙∙∙∙∙∙∙∙∙∙∙∙∙∙∙∙∙∙∙∙∙∙∙∙∙∙∙∙∙∙∙∙∙∙∙∙∙∙∙∙∙∙∙∙∙∙∙∙∙∙∙∙∙∙∙∙∙∙∙∙∙∙∙∙∙∙∙∙∙∙∙∙∙∙∙∙∙∙∙∙∙∙∙∙∙∙∙∙∙∙∙∙∙∙∙∙∙∙∙∙∙∙∙∙∙∙∙∙∙∙∙∙∙∙∙∙∙∙∙∙∙∙∙∙∙∙
    // ∙∙∙∙∙∙∙∙∙∙∙∙∙∙∙∙∙∙∙∙∙∙∙∙∙∙∙∙∙∙∙∙∙∙∙∙∙∙∙∙∙∙∙∙∙∙∙∙∙∙∙∙∙∙∙∙∙∙∙∙∙∙∙∙∙∙∙∙∙∙∙∙∙∙∙∙∙∙∙∙∙∙∙∙∙∙∙∙∙∙∙∙∙∙∙∙∙∙∙∙∙∙∙∙∙∙∙∙∙∙∙∙∙∙∙∙∙∙∙∙∙∙∙∙∙∙∙∙
    // ∙∙∙∙∙∙∙∙∙∙∙∙∙∙∙∙∙∙∙∙∙∙∙∙∙∙∙∙∙∙∙∙∙∙∙∙∙∙∙∙∙∙∙∙∙∙∙∙∙∙∙∙∙∙∙∙∙∙∙∙∙∙∙∙∙∙∙∙∙∙∙∙∙∙∙∙∙∙∙∙∙∙∙∙∙∙∙∙∙∙∙∙∙∙∙∙∙∙∙∙∙∙∙∙∙∙∙∙∙∙∙∙∙∙∙∙∙∙∙∙∙∙∙∙∙∙∙∙
    // ∙∙∙∙∙∙∙∙∙∙∙∙∙∙∙∙∙∙∙∙∙∙∙∙∙∙∙∙∙∙∙∙∙∙∙∙∙∙∙∙∙∙∙∙∙∙∙∙∙∙∙∙∙∙∙∙∙∙∙∙∙∙∙∙∙∙∙∙∙∙∙∙∙∙∙∙∙∙∙∙∙∙∙∙∙∙∙∙∙∙∙∙∙∙∙∙∙∙∙∙∙∙∙∙∙∙∙∙∙∙∙∙∙∙∙∙∙∙∙∙∙∙∙∙∙∙∙∙
    // ∙∙∙∙∙∙∙∙∙∙∙∙∙∙∙∙∙∙∙∙∙∙∙∙∙∙∙∙∙∙∙∙∙∙∙∙∙∙∙∙∙∙∙∙∙∙∙∙∙∙∙∙∙∙∙∙∙∙∙∙∙∙∙∙∙∙∙∙∙∙∙∙∙∙∙∙∙∙∙∙∙∙∙∙∙∙∙∙∙∙∙∙∙∙∙∙∙∙∙∙∙∙∙∙∙∙∙∙∙∙∙∙∙∙∙∙∙∙∙∙∙∙∙∙∙∙∙∙
    // ∙∙∙∙∙∙∙∙∙∙∙∙∙∙∙∙∙∙∙∙∙∙∙∙∙∙∙∙∙∙∙∙∙∙∙∙∙∙∙∙∙∙∙∙∙∙∙∙∙∙∙∙∙∙∙∙∙∙∙∙∙∙∙∙∙∙∙∙∙∙∙∙∙∙∙∙∙∙∙∙∙∙∙∙∙∙∙∙∙∙∙∙∙∙∙∙∙∙∙∙∙∙∙∙∙∙∙∙∙∙∙∙∙∙∙∙∙∙∙∙∙∙∙∙∙∙∙∙
    // ∙∙∙∙∙∙∙∙∙∙∙∙∙∙∙∙∙∙∙∙∙∙∙∙∙∙∙∙∙∙∙∙∙∙∙∙∙∙∙∙∙∙∙∙∙∙∙∙∙∙∙∙∙∙∙∙∙∙∙∙∙∙∙∙∙∙∙∙∙∙∙∙∙∙∙∙∙∙∙∙∙∙∙∙∙∙∙∙∙∙∙∙∙∙∙∙∙∙∙∙∙∙∙∙∙∙∙∙∙∙∙∙∙∙∙∙∙∙∙∙∙∙∙∙∙∙∙∙
    // ∙∙∙∙∙∙∙∙∙∙∙∙∙∙∙∙∙∙∙∙∙∙∙∙∙∙∙∙∙∙∙∙∙∙∙∙∙∙∙∙∙∙∙∙∙∙∙∙∙∙∙∙∙∙∙∙∙∙∙∙∙∙∙∙∙∙∙∙∙∙∙∙∙∙∙∙∙∙∙∙∙∙∙∙∙∙∙∙∙∙∙∙∙∙∙∙∙∙∙∙∙∙∙∙∙∙∙∙∙∙∙∙∙∙∙∙∙∙∙∙∙∙∙∙∙∙∙∙
    // ∙∙∙∙∙∙∙∙∙∙∙∙∙∙∙∙∙∙∙∙∙∙∙∙∙∙∙∙∙∙∙∙∙∙∙∙∙∙∙∙∙∙∙∙∙∙∙∙∙∙∙∙∙∙∙∙∙∙∙∙∙∙∙∙∙∙∙∙∙∙∙∙∙∙∙∙∙∙∙∙∙∙∙∙∙∙∙∙∙∙∙∙∙∙∙∙∙∙∙∙∙∙∙∙∙∙∙∙∙∙∙∙∙∙∙∙∙∙∙∙∙∙∙∙∙∙∙∙
    // ∙∙∙∙∙∙∙∙∙∙∙∙∙∙∙∙∙∙∙∙∙∙∙∙∙∙∙∙∙∙∙∙∙∙∙∙∙∙∙∙∙∙∙∙∙∙∙∙∙∙∙∙∙∙∙∙∙∙∙∙∙∙∙∙∙∙∙∙∙∙∙∙∙∙∙∙∙∙∙∙∙∙∙∙∙∙∙∙∙∙∙∙∙∙∙∙∙∙∙∙∙∙∙∙∙∙∙∙∙∙∙∙∙∙∙∙∙∙∙∙∙∙∙∙∙∙∙∙
    // ∙∙∙∙∙∙∙∙∙∙∙∙∙∙∙∙∙∙∙∙∙∙∙∙∙∙∙∙∙∙∙∙∙∙∙∙∙∙∙∙∙∙∙∙∙∙∙∙∙∙∙∙∙∙∙∙∙∙∙∙∙∙∙∙∙∙∙∙∙∙∙∙∙∙∙∙∙∙∙∙∙∙∙∙∙∙∙∙∙∙∙∙∙∙∙∙∙∙∙∙∙∙∙∙∙∙∙∙∙∙∙∙∙∙∙∙∙∙∙∙∙∙∙∙∙∙∙∙
    // ∙∙∙∙∙∙∙∙∙∙∙∙∙∙∙∙∙∙∙∙∙∙∙∙∙∙∙∙∙∙∙∙∙∙∙∙∙∙∙∙∙∙∙∙∙∙∙∙∙∙∙∙∙∙∙∙∙∙∙∙∙∙∙∙∙∙∙∙∙∙∙∙∙∙∙∙∙∙∙∙∙∙∙∙∙∙∙∙∙∙∙∙∙∙∙∙∙∙∙∙∙∙∙∙∙∙∙∙∙∙∙∙∙∙∙∙∙∙∙∙∙∙∙∙∙∙∙∙
    // ∙∙∙∙∙∙∙∙∙∙∙∙∙∙∙∙∙∙∙∙∙∙∙∙∙∙∙∙∙∙∙∙∙∙∙∙∙∙∙∙∙∙∙∙∙∙∙∙∙∙∙∙∙∙∙∙∙∙∙∙∙∙∙∙∙∙∙∙∙∙∙∙∙∙∙∙∙∙∙∙∙∙∙∙∙∙∙∙∙∙∙∙∙∙∙∙∙∙∙∙∙∙∙∙∙∙∙∙∙∙∙∙∙∙∙∙∙∙∙∙∙∙∙∙∙∙∙∙
    // ∙∙∙∙∙∙∙∙∙∙∙∙∙∙∙∙∙∙∙∙∙∙∙∙∙∙∙∙∙∙∙∙∙∙∙∙∙∙∙∙∙∙∙∙∙∙∙∙∙∙∙∙∙∙∙∙∙∙∙∙∙∙∙∙∙∙∙∙∙∙∙∙∙∙∙∙∙∙∙∙∙∙∙∙∙∙∙∙∙∙∙∙∙∙∙∙∙∙∙∙∙∙∙∙∙∙∙∙∙∙∙∙∙∙∙∙∙∙∙∙∙∙∙∙∙∙∙∙
    // ∙∙∙∙∙∙∙∙∙∙∙∙∙∙∙∙∙∙∙∙∙∙∙∙∙∙∙∙∙∙∙∙∙∙∙∙∙∙∙∙∙∙∙∙∙∙∙∙∙∙∙∙∙∙∙∙∙∙∙∙∙∙∙∙∙∙∙∙∙∙∙∙∙∙∙∙∙∙∙∙∙∙∙∙∙∙∙∙∙∙∙∙∙∙∙∙∙∙∙∙∙∙∙∙∙∙∙∙∙∙∙∙∙∙∙∙∙∙∙∙∙∙∙∙∙∙∙∙
    // ∙∙∙∙∙∙∙∙∙∙∙∙∙∙∙∙∙∙∙∙∙∙∙∙∙∙∙∙∙∙∙∙∙∙∙∙∙∙∙∙∙∙∙∙∙∙∙∙∙∙∙∙∙∙∙∙∙∙∙∙∙∙∙∙∙∙∙∙∙∙∙∙∙∙∙∙∙∙∙∙∙∙∙∙∙∙∙∙∙∙∙∙∙∙∙∙∙∙∙∙∙∙∙∙∙∙∙∙∙∙∙∙∙∙∙∙∙∙∙∙∙∙∙∙∙∙∙∙
    // ∙∙∙∙∙∙∙∙∙∙∙∙∙∙∙∙∙∙∙∙∙∙∙∙∙∙∙∙∙∙∙∙∙∙∙∙∙∙∙∙∙∙∙∙∙∙∙∙∙∙∙∙∙∙∙∙∙∙∙∙∙∙∙∙∙∙∙∙∙∙∙∙∙∙∙∙∙∙∙∙∙∙∙∙∙∙∙∙∙∙∙∙∙∙∙∙∙∙∙∙∙∙∙∙∙∙∙∙∙∙∙∙∙∙∙∙∙∙∙∙∙∙∙∙∙∙∙∙
    // ∙∙∙∙∙∙∙∙∙∙∙∙∙∙∙∙∙∙∙∙∙∙∙∙∙∙∙∙∙∙∙∙∙∙∙∙∙∙∙∙∙∙∙∙∙∙∙∙∙∙∙∙∙∙∙∙∙∙∙∙∙∙∙∙∙∙∙∙∙∙∙∙∙∙∙∙∙∙∙∙∙∙∙∙∙∙∙∙∙∙∙∙∙∙∙∙∙∙∙∙∙∙∙∙∙∙∙∙∙∙∙∙∙∙∙∙∙∙∙∙∙∙∙∙∙∙∙∙
    // ∙∙∙∙∙∙∙∙∙∙∙∙∙∙∙∙∙∙∙∙∙∙∙∙∙∙∙∙∙∙∙∙∙∙∙∙∙∙∙∙∙∙∙∙∙∙∙∙∙∙∙∙∙∙∙∙∙∙∙∙∙∙∙∙∙∙∙∙∙∙∙∙∙∙∙∙∙∙∙∙∙∙∙∙∙∙∙∙∙∙∙∙∙∙∙∙∙∙∙∙∙∙∙∙∙∙∙∙∙∙∙∙∙∙∙∙∙∙∙∙∙∙∙∙∙∙∙∙
    // ∙∙∙∙∙∙∙∙∙∙∙∙∙∙∙∙∙∙∙∙∙∙∙∙∙∙∙∙∙∙∙∙∙∙∙∙∙∙∙∙∙∙∙∙∙∙∙∙∙∙∙∙∙∙∙∙∙∙∙∙∙∙∙∙∙∙∙∙∙∙∙∙∙∙∙∙∙∙∙∙∙∙∙∙∙∙∙∙∙∙∙∙∙∙∙∙∙∙∙∙∙∙∙∙∙∙∙∙∙∙∙∙∙∙∙∙∙∙∙∙∙∙∙∙∙∙∙∙
    // ∙∙∙∙∙∙∙∙∙∙∙∙∙∙∙∙∙∙∙∙∙∙∙∙∙∙∙∙∙∙∙∙∙∙∙∙∙∙∙∙∙∙∙∙∙∙∙∙∙∙∙∙∙∙∙∙∙∙∙∙∙∙∙∙∙∙∙∙∙∙∙∙∙∙∙∙∙∙∙∙∙∙∙∙∙∙∙∙∙∙∙∙∙∙∙∙∙∙∙∙∙∙∙∙∙∙∙∙∙∙∙∙∙∙∙∙∙∙∙∙∙∙∙∙∙∙∙∙
    // ∙∙∙∙∙∙∙∙∙∙∙∙∙∙∙∙∙∙∙∙∙∙∙∙∙∙∙∙∙∙∙∙∙∙∙∙∙∙∙∙∙∙∙∙∙∙∙∙∙∙∙∙∙∙∙∙∙∙∙∙∙∙∙∙∙∙∙∙∙∙∙∙∙∙∙∙∙∙∙∙∙∙∙∙∙∙∙∙∙∙∙∙∙∙∙∙∙∙∙∙∙∙∙∙∙∙∙∙∙∙∙∙∙∙∙∙∙∙∙∙∙∙∙∙∙∙∙∙
    // ∙∙∙∙∙∙∙∙∙∙∙∙∙∙∙∙∙∙∙∙∙∙∙∙∙∙∙∙∙∙∙∙∙∙∙∙∙∙∙∙∙∙∙∙∙∙∙∙∙∙∙∙∙∙∙∙∙∙∙∙∙∙∙∙∙∙∙∙∙∙∙∙∙∙∙∙∙∙∙∙∙∙∙∙∙∙∙∙∙∙∙∙∙∙∙∙∙∙∙∙∙∙∙∙∙∙∙∙∙∙∙∙∙∙∙∙∙∙∙∙∙∙∙∙∙∙∙∙
    // ∙∙∙∙∙∙∙∙∙∙∙∙∙∙∙∙∙∙∙∙∙∙∙∙∙∙∙∙∙∙∙∙∙∙∙∙∙∙∙∙∙∙∙∙∙∙∙∙∙∙∙∙∙∙∙∙∙∙∙∙∙∙∙∙∙∙∙∙∙∙∙∙∙∙∙∙∙∙∙∙∙∙∙∙∙∙∙∙∙∙∙∙∙∙∙∙∙∙∙∙∙∙∙∙∙∙∙∙∙∙∙∙∙∙∙∙∙∙∙∙∙∙∙∙∙∙∙∙
    // ∙∙∙∙∙∙∙∙∙∙∙∙∙∙∙∙∙∙∙∙∙∙∙∙∙∙∙∙∙∙∙∙∙∙∙∙∙∙∙∙∙∙∙∙∙∙∙∙∙∙∙∙∙∙∙∙∙∙∙∙∙∙∙∙∙∙∙∙∙∙∙∙∙∙∙∙∙∙∙∙∙∙∙∙∙∙∙∙∙∙∙∙∙∙∙∙∙∙∙∙∙∙∙∙∙∙∙∙∙∙∙∙∙∙∙∙∙∙∙∙∙∙∙∙∙∙∙∙
    // ∙∙∙∙∙∙∙∙∙∙∙∙∙∙∙∙∙∙∙∙∙∙∙∙∙∙∙∙∙∙∙∙∙∙∙∙∙∙∙∙∙∙∙∙∙∙∙∙∙∙∙∙∙∙∙∙∙∙∙∙∙∙∙∙∙∙∙∙∙∙∙∙∙∙∙∙∙∙∙∙∙∙∙∙∙∙∙∙∙∙∙∙∙∙∙∙∙∙∙∙∙∙∙∙∙∙∙∙∙∙∙∙∙∙∙∙∙∙∙∙∙∙∙∙∙∙∙∙
    // ∙∙∙∙∙∙∙∙∙∙∙∙∙∙∙∙∙∙∙∙∙∙∙∙∙∙∙∙∙∙∙∙∙∙∙∙∙∙∙∙∙∙∙∙∙∙∙∙∙∙∙∙∙∙∙∙∙∙∙∙∙∙∙∙∙∙∙∙∙∙∙∙∙∙∙∙∙∙∙∙∙∙∙∙∙∙∙∙∙∙∙∙∙∙∙∙∙∙∙∙∙∙∙∙∙∙∙∙∙∙∙∙∙∙∙∙∙∙∙∙∙∙∙∙∙∙∙∙
    // ∙∙∙∙∙∙∙∙∙∙∙∙∙∙∙∙∙∙∙∙∙∙∙∙∙∙∙∙∙∙∙∙∙∙∙∙∙∙∙∙∙∙∙∙∙∙∙∙∙∙∙∙∙∙∙∙∙∙∙∙∙∙∙∙∙∙∙∙∙∙∙∙∙∙∙∙∙∙∙∙∙∙∙∙∙∙∙∙∙∙∙∙∙∙∙∙∙∙∙∙∙∙∙∙∙∙∙∙∙∙∙∙∙∙∙∙∙∙∙∙∙∙∙∙∙∙∙∙
    // ∙∙∙∙∙∙∙∙∙∙∙∙∙∙∙∙∙∙∙∙∙∙∙∙∙∙∙∙∙∙∙∙∙∙∙∙∙∙∙∙∙∙∙∙∙∙∙∙∙∙∙∙∙∙∙∙∙∙∙∙∙∙∙∙∙∙∙∙∙∙∙∙∙∙∙∙∙∙∙∙∙∙∙∙∙∙∙∙∙∙∙∙∙∙∙∙∙∙∙∙∙∙∙∙∙∙∙∙∙∙∙∙∙∙∙∙∙∙∙∙∙∙∙∙∙∙∙∙
    // ∙∙∙∙∙∙∙∙∙∙∙∙∙∙∙∙∙∙∙∙∙∙∙∙∙∙∙∙∙∙∙∙∙∙∙∙∙∙∙∙∙∙∙∙∙∙∙∙∙∙∙∙∙∙∙∙∙∙∙∙∙∙∙∙∙∙∙∙∙∙∙∙∙∙∙∙∙∙∙∙∙∙∙∙∙∙∙∙∙∙∙∙∙∙∙∙∙∙∙∙∙∙∙∙∙∙∙∙∙∙∙∙∙∙∙∙∙∙∙∙∙∙∙∙∙∙∙∙
    // ∙∙∙∙∙∙∙∙∙∙∙∙∙∙∙∙∙∙∙∙∙∙∙∙∙∙∙∙∙∙∙∙∙∙∙∙∙∙∙∙∙∙∙∙∙∙∙∙∙∙∙∙∙∙∙∙∙∙∙∙∙∙∙∙∙∙∙∙∙∙∙∙∙∙∙∙∙∙∙∙∙∙∙∙∙∙∙∙∙∙∙∙∙∙∙∙∙∙∙∙∙∙∙∙∙∙∙∙∙∙∙∙∙∙∙∙∙∙∙∙∙∙∙∙∙∙∙∙
    // ∙∙∙∙∙∙∙∙∙∙∙∙∙∙∙∙∙∙∙∙∙∙∙∙∙∙∙∙∙∙∙∙∙∙∙∙∙∙∙∙∙∙∙∙∙∙∙∙∙∙∙∙∙∙∙∙∙∙∙∙∙∙∙∙∙∙∙∙∙∙∙∙∙∙∙∙∙∙∙∙∙∙∙∙∙∙∙∙∙∙∙∙∙∙∙∙∙∙∙∙∙∙∙∙∙∙∙∙∙∙∙∙∙∙∙∙∙∙∙∙∙∙∙∙∙∙∙∙
    // ∙∙∙∙∙∙∙∙∙∙∙∙∙∙∙∙∙∙∙∙∙∙∙∙∙∙∙∙∙∙∙∙∙∙∙∙∙∙∙∙∙∙∙∙∙∙∙∙∙∙∙∙∙∙∙∙∙∙∙∙∙∙∙∙∙∙∙∙∙∙∙∙∙∙∙∙∙∙∙∙∙∙∙∙∙∙∙∙∙∙∙∙∙∙∙∙∙∙∙∙∙∙∙∙∙∙∙∙∙∙∙∙∙∙∙∙∙∙∙∙∙∙∙∙∙∙∙∙
    // ∙∙∙∙∙∙∙∙∙∙∙∙∙∙∙∙∙∙∙∙∙∙∙∙∙∙∙∙∙∙∙∙∙∙∙∙∙∙∙∙∙∙∙∙∙∙∙∙∙∙∙∙∙∙∙∙∙∙∙∙∙∙∙∙∙∙∙∙∙∙∙∙∙∙∙∙∙∙∙∙∙∙∙∙∙∙∙∙∙∙∙∙∙∙∙∙∙∙∙∙∙∙∙∙∙∙∙∙∙∙∙∙∙∙∙∙∙∙∙∙∙∙∙∙∙∙∙∙
    // ∙∙∙∙∙∙∙∙∙∙∙∙∙∙∙∙∙∙∙∙∙∙∙∙∙∙∙∙∙∙∙∙∙∙∙∙∙∙∙∙∙∙∙∙∙∙∙∙∙∙∙∙∙∙∙∙∙∙∙∙∙∙∙∙∙∙∙∙∙∙∙∙∙∙∙∙∙∙∙∙∙∙∙∙∙∙∙∙∙∙∙∙∙∙∙∙∙∙∙∙∙∙∙∙∙∙∙∙∙∙∙∙∙∙∙∙∙∙∙∙∙∙∙∙∙∙∙∙
    // ∙∙∙∙∙∙∙∙∙∙∙∙∙∙∙∙∙∙∙∙∙∙∙∙∙∙∙∙∙∙∙∙∙∙∙∙∙∙∙∙∙∙∙∙∙∙∙∙∙∙∙∙∙∙∙∙∙∙∙∙∙∙∙∙∙∙∙∙∙∙∙∙∙∙∙∙∙∙∙∙∙∙∙∙∙∙∙∙∙∙∙∙∙∙∙∙∙∙∙∙∙∙∙∙∙∙∙∙∙∙∙∙∙∙∙∙∙∙∙∙∙∙∙∙∙∙∙∙
    // ∙∙∙∙∙∙∙∙∙∙∙∙∙∙∙∙∙∙∙∙∙∙∙∙∙∙∙∙∙∙∙∙∙∙∙∙∙∙∙∙∙∙∙∙∙∙∙∙∙∙∙∙∙∙∙∙∙∙∙∙∙∙∙∙∙∙∙∙∙∙∙∙∙∙∙∙∙∙∙∙∙∙∙∙∙∙∙∙∙∙∙∙∙∙∙∙∙∙∙∙∙∙∙∙∙∙∙∙∙∙∙∙∙∙∙∙∙∙∙∙∙∙∙∙∙∙∙∙
    // ∙∙∙∙∙∙∙∙∙∙∙∙∙∙∙∙∙∙∙∙∙∙∙∙∙∙∙∙∙∙∙∙∙∙∙∙∙∙∙∙∙∙∙∙∙∙∙∙∙∙∙∙∙∙∙∙∙∙∙∙∙∙∙∙∙∙∙∙∙∙∙∙∙∙∙∙∙∙∙∙∙∙∙∙∙∙∙∙∙∙∙∙∙∙∙∙∙∙∙∙∙∙∙∙∙∙∙∙∙∙∙∙∙∙∙∙∙∙∙∙∙∙∙∙∙∙∙∙
    // ∙∙∙∙∙∙∙∙∙∙∙∙∙∙∙∙∙∙∙∙∙∙∙∙∙∙∙∙∙∙∙∙∙∙∙∙∙∙∙∙∙∙∙∙∙∙∙∙∙∙∙∙∙∙∙∙∙∙∙∙∙∙∙∙∙∙∙∙∙∙∙∙∙∙∙∙∙∙∙∙∙∙∙∙∙∙∙∙∙∙∙∙∙∙∙∙∙∙∙∙∙∙∙∙∙∙∙∙∙∙∙∙∙∙∙∙∙∙∙∙∙∙∙∙∙∙∙∙
    // ∙∙∙∙∙∙∙∙∙∙∙∙∙∙∙∙∙∙∙∙∙∙∙∙∙∙∙∙∙∙∙∙∙∙∙∙∙∙∙∙∙∙∙∙∙∙∙∙∙∙∙∙∙∙∙∙∙∙∙∙∙∙∙∙∙∙∙∙∙∙∙∙∙∙∙∙∙∙∙∙∙∙∙∙∙∙∙∙∙∙∙∙∙∙∙∙∙∙∙∙∙∙∙∙∙∙∙∙∙∙∙∙∙∙∙∙∙∙∙∙∙∙∙∙∙∙∙∙
    // ∙∙∙∙∙∙∙∙∙∙∙∙∙∙∙∙∙∙∙∙∙∙∙∙∙∙∙∙∙∙∙∙∙∙∙∙∙∙∙∙∙∙∙∙∙∙∙∙∙∙∙∙∙∙∙∙∙∙∙∙∙∙∙∙∙∙∙∙∙∙∙∙∙∙∙∙∙∙∙∙∙∙∙∙∙∙∙∙∙∙∙∙∙∙∙∙∙∙∙∙∙∙∙∙∙∙∙∙∙∙∙∙∙∙∙∙∙∙∙∙∙∙∙∙∙∙∙∙
    // ∙∙∙∙∙∙∙∙∙∙∙∙∙∙∙∙∙∙∙∙∙∙∙∙∙∙∙∙∙∙∙∙∙∙∙∙∙∙∙∙∙∙∙∙∙∙∙∙∙∙∙∙∙∙∙∙∙∙∙∙∙∙∙∙∙∙∙∙∙∙∙∙∙∙∙∙∙∙∙∙∙∙∙∙∙∙∙∙∙∙∙∙∙∙∙∙∙∙∙∙∙∙∙∙∙∙∙∙∙∙∙∙∙∙∙∙∙∙∙∙∙∙∙∙∙∙∙∙
    // ∙∙∙∙∙∙∙∙∙∙∙∙∙∙∙∙∙∙∙∙∙∙∙∙∙∙∙∙∙∙∙∙∙∙∙∙∙∙∙∙∙∙∙∙∙∙∙∙∙∙∙∙∙∙∙∙∙∙∙∙∙∙∙∙∙∙∙∙∙∙∙∙∙∙∙∙∙∙∙∙∙∙∙∙∙∙∙∙∙∙∙∙∙∙∙∙∙∙∙∙∙∙∙∙∙∙∙∙∙∙∙∙∙∙∙∙∙∙∙∙∙∙∙∙∙∙∙∙
    // ∙∙∙∙∙∙∙∙∙∙∙∙∙∙∙∙∙∙∙∙∙∙∙∙∙∙∙∙∙∙∙∙∙∙∙∙∙∙∙∙∙∙∙∙∙∙∙∙∙∙∙∙∙∙∙∙∙∙∙∙∙∙∙∙∙∙∙∙∙∙∙∙∙∙∙∙∙∙∙∙∙∙∙∙∙∙∙∙∙∙∙∙∙∙∙∙∙∙∙∙∙∙∙∙∙∙∙∙∙∙∙∙∙∙∙∙∙∙∙∙∙∙∙∙∙∙∙∙
    // ∙∙∙∙∙∙∙∙∙∙∙∙∙∙∙∙∙∙∙∙∙∙∙∙∙∙∙∙∙∙∙∙∙∙∙∙∙∙∙∙∙∙∙∙∙∙∙∙∙∙∙∙∙∙∙∙∙∙∙∙∙∙∙∙∙∙∙∙∙∙∙∙∙∙∙∙∙∙∙∙∙∙∙∙∙∙∙∙∙∙∙∙∙∙∙∙∙∙∙∙∙∙∙∙∙∙∙∙∙∙∙∙∙∙∙∙∙∙∙∙∙∙∙∙∙∙∙∙
    // ∙∙∙∙∙∙∙∙∙∙∙∙∙∙∙∙∙∙∙∙∙∙∙∙∙∙∙∙∙∙∙∙∙∙∙∙∙∙∙∙∙∙∙∙∙∙∙∙∙∙∙∙∙∙∙∙∙∙∙∙∙∙∙∙∙∙∙∙∙∙∙∙∙∙∙∙∙∙∙∙∙∙∙∙∙∙∙∙∙∙∙∙∙∙∙∙∙∙∙∙∙∙∙∙∙∙∙∙∙∙∙∙∙∙∙∙∙∙∙∙∙∙∙∙∙∙∙∙
    // ∙∙∙∙∙∙∙∙∙∙∙∙∙∙∙∙∙∙∙∙∙∙∙∙∙∙∙∙∙∙∙∙∙∙∙∙∙∙∙∙∙∙∙∙∙∙∙∙∙∙∙∙∙∙∙∙∙∙∙∙∙∙∙∙∙∙∙∙∙∙∙∙∙∙∙∙∙∙∙∙∙∙∙∙∙∙∙∙∙∙∙∙∙∙∙∙∙∙∙∙∙∙∙∙∙∙∙∙∙∙∙∙∙∙∙∙∙∙∙∙∙∙∙∙∙∙∙∙
    // ∙█∙∙∙█∙∙∙█∙∙∙█∙∙∙█∙∙∙█∙∙∙█∙∙∙█∙∙∙█∙∙∙█∙∙∙█∙∙∙█∙∙∙█∙∙∙█∙∙∙█∙∙∙█∙∙∙█∙∙∙█∙∙∙█∙∙∙█∙∙∙█∙∙∙█∙∙∙█∙∙∙█∙∙∙█∙∙∙█∙∙∙█∙∙∙█∙∙∙█∙∙∙█∙∙∙█∙∙∙█∙∙
    // █∙█∙█∙█∙█∙█∙█∙█∙█∙█∙█∙█∙█∙█∙█∙█∙█∙█∙█∙█∙█∙█∙█∙█∙█∙█∙█∙█∙█∙█∙█∙█∙█∙█∙█∙█∙█∙█∙█∙█∙█∙█∙█∙█∙█∙█∙█∙█∙█∙█∙█∙█∙█∙█∙█∙█∙█∙█∙█∙█∙█∙█∙█∙█∙
    // ∙∙∙█∙∙∙█∙∙∙█∙∙∙█∙∙∙█∙∙∙█∙∙∙█∙∙∙█∙∙∙█∙∙∙█∙∙∙█∙∙∙█∙∙∙█∙∙∙█∙∙∙█∙∙∙█∙∙∙█∙∙∙█∙∙∙█∙∙∙█∙∙∙█∙∙∙█∙∙∙█∙∙∙█∙∙∙█∙∙∙█∙∙∙█∙∙∙█∙∙∙█∙∙∙█∙∙∙█∙∙∙█
    // █∙█∙█∙█∙█∙█∙█∙█∙█∙█∙█∙█∙█∙█∙█∙█∙█∙█∙█∙█∙█∙█∙█∙█∙█∙█∙█∙█∙█∙█∙█∙█∙█∙█∙█∙█∙█∙█∙█∙█∙█∙█∙█∙█∙█∙█∙█∙█∙█∙█∙█∙█∙█∙█∙█∙█∙█∙█∙█∙█∙█∙█∙█∙█∙
    // ∙█∙∙∙█∙∙∙█∙█∙█∙∙∙█∙∙∙█∙∙∙█∙█∙█∙∙∙█∙∙∙█∙∙∙█∙█∙█∙∙∙█∙∙∙█∙∙∙█∙█∙█∙∙∙█∙∙∙█∙∙∙█∙█∙█∙∙∙█∙∙∙█∙∙∙█∙█∙█∙∙∙█∙∙∙█∙∙∙█∙█∙█∙∙∙█∙∙∙█∙∙∙█∙█∙█∙∙
    // ∙∙∙∙∙∙∙∙∙∙∙∙∙∙∙∙∙∙∙∙∙∙∙∙∙∙∙∙∙∙∙∙∙∙∙∙∙∙∙∙∙∙∙∙∙∙∙∙∙∙∙∙∙∙∙∙∙∙∙∙∙∙∙∙∙∙∙∙∙∙∙∙∙∙∙∙∙∙∙∙∙∙∙∙∙∙∙∙∙∙∙∙∙∙∙∙∙∙∙∙∙∙∙∙∙∙∙∙∙∙∙∙∙∙∙∙∙∙∙∙∙∙∙∙∙∙∙∙
    // ∙∙∙∙∙∙∙∙∙∙∙∙∙∙∙∙∙∙∙∙∙∙∙∙∙∙∙∙∙∙∙∙∙∙∙∙∙∙∙∙∙∙∙∙∙∙∙∙∙∙∙∙∙∙∙∙∙∙∙∙∙∙∙∙∙∙∙∙∙∙∙∙∙∙∙∙∙∙∙∙∙∙∙∙∙∙∙∙∙∙∙∙∙∙∙∙∙∙∙∙∙∙∙∙∙∙∙∙∙∙∙∙∙∙∙∙∙∙∙∙∙∙∙∙∙∙∙∙
    // ∙∙∙∙∙∙∙∙∙∙∙∙∙∙∙∙∙∙∙∙∙∙∙∙∙∙∙∙∙∙∙∙∙∙∙∙∙∙∙∙∙∙∙∙∙∙∙∙∙∙∙∙∙∙∙∙∙∙∙∙∙∙∙∙∙∙∙∙∙∙∙∙∙∙∙∙∙∙∙∙∙∙∙∙∙∙∙∙∙∙∙∙∙∙∙∙∙∙∙∙∙∙∙∙∙∙∙∙∙∙∙∙∙∙∙∙∙∙∙∙∙∙∙∙∙∙∙∙
    // ∙∙∙∙∙∙∙∙∙∙∙∙∙∙∙∙∙∙∙∙∙∙∙∙∙∙∙∙∙∙∙∙∙∙∙∙∙∙∙∙∙∙∙∙∙∙∙∙∙∙∙∙∙∙∙∙∙∙∙∙∙∙∙∙∙∙∙∙∙∙∙∙∙∙∙∙∙∙∙∙∙∙∙∙∙∙∙∙∙∙∙∙∙∙∙∙∙∙∙∙∙∙∙∙∙∙∙∙∙∙∙∙∙∙∙∙∙∙∙∙∙∙∙∙∙∙∙∙
    // ∙∙∙∙∙∙∙∙∙∙∙∙∙∙∙∙∙∙∙∙∙∙∙∙∙∙∙∙∙∙∙∙∙∙∙∙∙∙∙∙∙∙∙∙∙∙∙∙∙∙∙∙∙∙∙∙∙∙∙∙∙∙∙∙∙∙∙∙∙∙∙∙∙∙∙∙∙∙∙∙∙∙∙∙∙∙∙∙∙∙∙∙∙∙∙∙∙∙∙∙∙∙∙∙∙∙∙∙∙∙∙∙∙∙∙∙∙∙∙∙∙∙∙∙∙∙∙∙
    // ∙∙∙∙∙∙∙∙∙∙∙∙∙∙∙∙∙∙∙∙∙∙∙∙∙∙∙∙∙∙∙∙∙∙∙∙∙∙∙∙∙∙∙∙∙∙∙∙∙∙∙∙∙∙∙∙∙∙∙∙∙∙∙∙∙∙∙∙∙∙∙∙∙∙∙∙∙∙∙∙∙∙∙∙∙∙∙∙∙∙∙∙∙∙∙∙∙∙∙∙∙∙∙∙∙∙∙∙∙∙∙∙∙∙∙∙∙∙∙∙∙∙∙∙∙∙∙∙
    // ∙∙∙∙∙∙∙∙∙∙∙∙∙∙∙∙∙∙∙∙∙∙∙∙∙∙∙∙∙∙∙∙∙∙∙∙∙∙∙∙∙∙∙∙∙∙∙∙∙∙∙∙∙∙∙∙∙∙∙∙∙∙∙∙∙∙∙∙∙∙∙∙∙∙∙∙∙∙∙∙∙∙∙∙∙∙∙∙∙∙∙∙∙∙∙∙∙∙∙∙∙∙∙∙∙∙∙∙∙∙∙∙∙∙∙∙∙∙∙∙∙∙∙∙∙∙∙∙
    // ∙∙∙∙∙∙∙∙∙∙∙∙∙∙∙∙∙∙∙∙∙∙∙∙∙∙∙∙∙∙∙∙∙∙∙∙∙∙∙∙∙∙∙∙∙∙∙∙∙∙∙∙∙∙∙∙∙∙∙∙∙∙∙∙∙∙∙∙∙∙∙∙∙∙∙∙∙∙∙∙∙∙∙∙∙∙∙∙∙∙∙∙∙∙∙∙∙∙∙∙∙∙∙∙∙∙∙∙∙∙∙∙∙∙∙∙∙∙∙∙∙∙∙∙∙∙∙∙
    // ∙∙∙∙∙∙∙∙∙∙∙∙∙∙∙∙∙∙∙∙∙∙∙∙∙∙∙∙∙∙∙∙∙∙∙∙∙∙∙∙∙∙∙∙∙∙∙∙∙∙∙∙∙∙∙∙∙∙∙∙∙∙∙∙∙∙∙∙∙∙∙∙∙∙∙∙∙∙∙∙∙∙∙∙∙∙∙∙∙∙∙∙∙∙∙∙∙∙∙∙∙∙∙∙∙∙∙∙∙∙∙∙∙∙∙∙∙∙∙∙∙∙∙∙∙∙∙∙
    0x11, 0x11, 0x11, 0x11, 0x11, 0x11, 0x11, 0x11, 0x11, 0x11, 0x11, 0x11, 0x11, 0x11, 0x11, 0x11, 
    0xaa, 0xaa, 0xaa, 0xaa, 0xaa, 0xaa, 0xaa, 0xaa, 0xaa, 0xaa, 0xaa, 0xaa, 0xaa, 0xaa, 0xaa, 0xaa, 
    0x44, 0x44, 0x44, 0x44, 0x44, 0x44, 0x44, 0x44, 0x44, 0x44, 0x44, 0x44, 0x44, 0x44, 0x44, 0x44, 
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    0x00, 0x00, 0x00, 0x00, 0x00, 0x00, 0x00, 0x00, 0x00, 0x00, 0x00, 0x00, 0x00, 0x00, 0x00, 0x00
};
static const uint8_t image_data_enemy[5] = {
    // █∙█∙█
    // ∙█∙█∙
    // █∙█∙█
    // ∙█∙█∙
    // █∙█∙█
    0xa8, 
    0x50, 
    0xa8, 
    0x50, 
    0xa8
};
void setup() {
  // put your setup code here, to run once:
 Serial.begin(9600);
 pinMode(left, INPUT); // button init
 pinMode(right, INPUT);
 pinMode(fire, INPUT);

  // SSD1306_SWITCHCAPVCC = generate display voltage from 3.3V internally
  if(!display.begin(SSD1306_SWITCHCAPVCC, SCREEN_ADDRESS)) {
    Serial.println(F("SSD1306 allocation failed"));}
  display.clearDisplay();
  display.setTextSize(1);
  display.setTextColor(WHITE);
  display.setCursor(0, 0);
  display.println("Starting...");
  display.display();
  delay(1000);
  display.setCursor(0, 16);
  display.println("RAM... OK");
  display.display();
  delay(200);
  display.setCursor(0, 32);
  display.println("Graphics... OTVAL");
  display.display();
  delay(300);
  display.setCursor(0, 48);
  display.println("All systems nominal");
  display.display();
  delay(500);
display.clearDisplay();
display.drawBitmap(0,0, image_data_binbows, 128, 64, 1);
display.display();
delay(100);
display.clearDisplay();
  display.invertDisplay(true);
  delay(500);
  display.invertDisplay(false);
  delay(500);
  display.drawBitmap(0,0, image_data_boot1, 128, 64, 1);
  display.display();
  //delay(5000);
  display.clearDisplay();
    display.drawBitmap(0,0, image_data_boot2, 128, 64, 1);
  display.display();
  //delay(1000);
  display.clearDisplay();
    display.drawBitmap(0,0, image_data_desk, 128, 64, 1);
  display.display();
  if (fire == HIGH){
    on=1;
    display.clearDisplay();

}
  //r=0;
  A[0]=10;
PLY=60;
}
int PRX; // Projectile pos X and Y
int PRY;


void loop() {

switch (on){ // Check if game is on
  case 1:
    display.clearDisplay(); // Clearing display on every frame
    display.drawBitmap(0,0, image_data_bg, 128, 64, 1); // Draw background

    firest=digitalRead(fire); // Reading buttons on every frame
    leftst=digitalRead(left);
    rightst=digitalRead(right);

    if (PRS==1) display.drawPixel(PRX,PRY,WHITE); // Draw Projectile

  switch (A[25]){ // Drawing enemy 1
    case 1:
    display.drawBitmap(A[0],y, image_data_enemy,5,5,WHITE);
    //display.display();
    break;}

  switch (B[25]){ // Drawing enemy 2
    case 1:
    display.drawBitmap(B[0],y, image_data_enemy,5,5,WHITE);
    //display.display();
    break;}

  switch (C[25]){ // Drawing enemy 3
    case 1:
    display.drawBitmap(C[0],y, image_data_enemy,5,5,WHITE);
    //display.drawRect(C[0],y,5,5,WHITE); // Optional enemy rectangle graphics
    //display.display();
    break;}
    
  switch (D[25]){ // Drawing enemy 4
    case 1:
    display.drawBitmap(D[0],y, image_data_enemy,5,5,WHITE);
    //display.drawRect(D[0],y,5,5,WHITE);
    //display.display();
    break;}

  switch (E[25]){ // Drawing enemy 5
    case 1:
    display.drawBitmap(E[0],y, image_data_enemy,5,5,WHITE);
    //display.drawRect(E[0],y,5,5,WHITE);
    //display.display();
    break;}

  switch (F[25]){ // Drawing enemy 6
    case 1:
    display.drawBitmap(F[0],y, image_data_enemy,5,5,WHITE);
    //display.drawRect(F[0],y,5,5,WHITE);
    //display.display();
    break;}
  display.drawPixel(PLX,PLY,WHITE); // Draw Player gun
  display.drawLine(PLX-1,PLY+1,PLX+1,PLY+1,WHITE); // Draw Player body

  display.setCursor(16,16); // Debug for buttons
  display.println(leftst); // Uncomment this segment to test your buttons
  display.setCursor(32,16); // Draws left, right and fire buttons status
  display.println(rightst);
  display.setCursor(48,16);
  display.println(firest);

display.display(); // Display graphics

  switch (A[0]){ // Enemy base tile movement
    case 2 ... 68: 
      if (r==0){
      A[0]++;}
      else A[0]--;
    break;
    case 69 ... 127:
      r=1;
      y=y+5;
      A[0]=67;
    break;
    case -127 ... 1:
    r=0;
    y=y+5;
    A[0]=3;
    break;
  }

  A[1]=A[2]=A[3]=A[4]=A[0]; // Moving enemy 1 hitbox
  A[5]=A[6]=A[7]=A[8]=A[9]=A[0]+1;
  A[10]=A[11]=A[12]=A[13]=A[14]=A[0]+2;
  A[15]=A[16]=A[17]=A[18]=A[19]=A[0]+3;
  A[20]=A[21]=A[22]=A[23]=A[24]=A[0]+4;

  B[1]=B[2]=B[3]=B[4]=B[0]=A[0]+10; // Moving enemy 2 hitbox
  B[5]=B[6]=B[7]=B[8]=B[9]=B[0]+1;
  B[10]=B[11]=B[12]=B[13]=B[14]=B[0]+2;
  B[15]=B[16]=B[17]=B[18]=B[19]=B[0]+3;
  B[20]=B[21]=B[22]=B[23]=B[24]=B[0]+4;

  C[1]=C[2]=C[3]=C[4]=C[0]=A[0]+20; // Moving enemy 3 hitbox
  C[5]=C[6]=C[7]=C[8]=C[9]=C[0]+1;
  C[10]=C[11]=C[12]=C[13]=C[14]=C[0]+2;
  C[15]=C[16]=C[17]=C[18]=C[19]=C[0]+3;
  C[20]=C[21]=C[22]=C[23]=C[24]=C[0]+4;

  D[1]=D[2]=D[3]=D[4]=D[0]=A[0]+30; // Moving enemy 4 hitbox
  D[5]=D[6]=D[7]=D[8]=D[9]=D[0]+1;
  D[10]=D[11]=D[12]=D[13]=D[14]=D[0]+2;
  D[15]=D[16]=D[17]=D[18]=D[19]=D[0]+3;
  D[20]=D[21]=D[22]=D[23]=D[24]=D[0]+4;

  E[1]=E[2]=E[3]=E[4]=E[0]=A[0]+40; // Moving enemy 5 hitbox
  E[5]=E[6]=E[7]=E[8]=E[9]=E[0]+1;
  E[10]=E[11]=E[12]=E[13]=E[14]=E[0]+2;
  E[15]=E[16]=E[17]=E[18]=E[19]=E[0]+3;
  E[20]=E[21]=E[22]=E[23]=E[24]=E[0]+4;

  F[1]=F[2]=F[3]=F[4]=F[0]=A[0]+50; // Moving enemy 6 hitbox
  F[5]=F[6]=F[7]=F[8]=F[9]=F[0]+1;
  F[10]=F[11]=F[12]=F[13]=F[14]=F[0]+2;
  F[15]=F[16]=F[17]=F[18]=F[19]=F[0]+3;
  F[20]=F[21]=F[22]=F[23]=F[24]=F[0]+4;

  if (PRS==1){ // Projectile movement
    switch (PRY){
      case 0 ... 64:
      PRY--;
      break;
      case -64 ... -1:
      PRS=0;
      break;
    }
  }

switch (PRS){ // Hit calculation
  case 1:
    if (PRY==y || PRY==y+1 || PRY==y+2 || PRY==y+3 || PRY==y+4){ // Projectile Y comparison
      for (int i=0; i<24; i++){
          if (PRX==A[i] && A[25]==1) {  // Enemy 1 damage check
            A[25]=0;
            PRS=0;}
          if (PRX==B[i] && B[25]==1){  // Enemy 2 damage check
            B[25]=0;
            PRS=0;}
          if (PRX==C[i] && C[25]==1){  // Enemy 3 damage check
            C[25]=0;
            PRS=0;}
          if (PRX==D[i] && D[25]==1){  // Enemy 4 damage check
            D[25]=0;
            PRS=0;}
          if (PRX==E[i] && E[25]==1){  // Enemy 5 damage check
            E[25]=0;
            PRS=0;}
          if (PRX==F[i] && F[25]==1){  // Enemy 6 damage check
            F[25]=0;
            PRS=0;}
      }
    }
  break;
}

  if (leftst==HIGH) PLX=PLX-3; // Player movement
  if (rightst==HIGH) PLX=PLX+3;
  if (PLX>125) PLX=3;
  if (PLX<3) PLX=125;
  if (PRS==0 && firest==HIGH){
    PRS=1;
    PRX=PLX;
    PRY=PLY;}

if (A[25]==0 && B[25]==0 && C[25]==0 && D[25]==0 && E[25]==0 && F[25]==0) on=3;
if (y>48) on=2;

delay(base);

break;

case 0:
  firest=digitalRead(fire); // Waiting for game start
  if (firest==HIGH) on=1;
break;

case 2:
  display.clearDisplay(); // Game over
  display.setCursor(16,32);
  display.println("GAME OVER");
  display.display();
break;

case 3:
  display.clearDisplay(); // Level completion
  display.setCursor(16,32);
  display.println("You win!");
  display.display();
break;
}}
